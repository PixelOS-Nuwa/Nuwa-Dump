/dts-v1/;

/ {
	model = "Qualcomm Technologies, Inc. Kalama QRD";
	compatible = "qcom,kalama-qrd", "qcom,kalama", "qcom,qrd";
	qcom,msm-id = <0x258 0x20000 0x259 0x20000>;
	qcom,board-id = <0x1000b 0x00>;

	fragment@0 {
		target = <0xffffffff>;

		__overlay__ {
			#address-cells = <0x02>;
			#size-cells = <0x00>;
			interrupt-controller;
			#interrupt-cells = <0x04>;

			qcom,pm8550@1 {
				compatible = "qcom,spmi-pmic";
				reg = <0x01 0x00>;
				#address-cells = <0x01>;
				#size-cells = <0x00>;

				pm8550-temp-alarm@a00 {
					compatible = "qcom,spmi-temp-alarm";
					reg = <0xa00>;
					interrupts = <0x01 0x0a 0x00 0x03>;
					#thermal-sensor-cells = <0x00>;
					io-channels = <0x01 0x103>;
					io-channel-names = "thermal";
					phandle = <0x05>;
				};

				pinctrl@8800 {
					compatible = "qcom,pm8550-gpio";
					reg = <0x8800>;
					gpio-controller;
					#gpio-cells = <0x02>;
					interrupt-controller;
					#interrupt-cells = <0x02>;
					phandle = <0x16>;

					key_vol_up {

						key_vol_up_default {
							pins = "gpio6";
							function = "normal";
							input-enable;
							bias-pull-up;
							power-source = <0x01>;
							phandle = <0x2b>;
						};
					};

					sd_card_det {

						sd_card_det_default {
							pins = "gpio12";
							function = "normal";
							input-enable;
							output-disable;
							bias-pull-up;
							power-source = <0x01>;
							phandle = <0x2a>;
						};
					};
				};

				pwms@e800 {
					compatible = "qcom,pwm-lpg";
					reg = <0xe800>;
					reg-names = "lpg-base";
					#pwm-cells = <0x02>;
					qcom,num-lpg-channels = <0x03>;
					nvmem = <0x02 0x03>;
					nvmem-names = "lpg_chan_sdam", "lut_sdam";
					qcom,lut-sdam-base = <0x45>;
					qcom,lut-patterns = <0x00 0x0a 0x14 0x1e 0x28 0x32 0x3c 0x46 0x50 0x5a 0x64 0x5a 0x50 0x46 0x3c 0x32 0x28 0x1e 0x14 0x0a 0x00>;
					qcom,tick-duration-us = <0x1e78>;
					phandle = <0x04>;

					lpg@1 {
						qcom,lpg-chan-id = <0x01>;
						qcom,ramp-step-ms = <0x64>;
						qcom,ramp-low-index = <0x00>;
						qcom,ramp-high-index = <0x13>;
						qcom,ramp-pattern-repeat;
						qcom,lpg-sdam-base = <0x48>;
					};

					lpg@2 {
						qcom,lpg-chan-id = <0x02>;
						qcom,ramp-step-ms = <0x64>;
						qcom,ramp-low-index = <0x00>;
						qcom,ramp-high-index = <0x13>;
						qcom,ramp-pattern-repeat;
						qcom,lpg-sdam-base = <0x56>;
					};

					lpg@3 {
						qcom,lpg-chan-id = <0x03>;
						qcom,ramp-step-ms = <0x64>;
						qcom,ramp-low-index = <0x00>;
						qcom,ramp-high-index = <0x13>;
						qcom,ramp-pattern-repeat;
						qcom,lpg-sdam-base = <0x64>;
					};
				};

				pwms@eb00 {
					compatible = "qcom,pwm-lpg";
					reg = <0xeb00>;
					reg-names = "lpg-base";
					#pwm-cells = <0x02>;
					qcom,num-lpg-channels = <0x01>;
					phandle = <0x30>;
				};

				qcom,leds@ef00 {
					compatible = "qcom,tri-led";
					reg = <0xef00>;
					phandle = <0x31>;

					red {
						label = "red";
						pwms = <0x04 0x00 0xf4240>;
						led-sources = <0x00>;
						linux,default-trigger = "timer";
					};

					green {
						label = "green";
						pwms = <0x04 0x01 0xf4240>;
						led-sources = <0x01>;
						linux,default-trigger = "timer";
					};

					blue {
						label = "blue";
						pwms = <0x04 0x02 0xf4240>;
						led-sources = <0x02>;
						linux,default-trigger = "timer";
					};
				};

				bcl@4700 {
					compatible = "qcom,bcl-v5";
					reg = <0x4700 0x100>;
					interrupts = <0x01 0x47 0x00 0x00 0x01 0x47 0x01 0x00 0x01 0x47 0x02 0x00>;
					interrupt-names = "bcl-lvl0", "bcl-lvl1", "bcl-lvl2";
					qcom,pmic7-threshold;
					#thermal-sensor-cells = <0x01>;
					phandle = <0x06>;
				};

				qcom,flash_led@ee00 {
					compatible = "qcom,pm8350c-flash-led";
					reg = <0xee00>;
					interrupts = <0x01 0xee 0x00 0x01 0x01 0xee 0x03 0x01 0x01 0xee 0x04 0x01>;
					interrupt-names = "led-fault-irq", "all-ramp-down-done-irq", "all-ramp-up-done-irq";
					qcom,thermal-derate-current = <0xc8 0x1f4>;
					status = "ok";
					phandle = <0x32>;

					qcom,flash_0 {
						label = "flash";
						qcom,led-name = "led:flash_0";
						qcom,max-current-ma = <0x5dc>;
						qcom,default-led-trigger = "flash0_trigger";
						qcom,id = <0x00>;
						qcom,duration-ms = <0x500>;
						qcom,ires-ua = <0x30d4>;
						phandle = <0x33>;
					};

					qcom,flash_1 {
						label = "flash";
						qcom,led-name = "led:flash_1";
						qcom,max-current-ma = <0x5dc>;
						qcom,default-led-trigger = "flash1_trigger";
						qcom,id = <0x01>;
						qcom,duration-ms = <0x500>;
						qcom,ires-ua = <0x30d4>;
						phandle = <0x34>;
					};

					qcom,flash_2 {
						label = "flash";
						qcom,led-name = "led:flash_2";
						qcom,max-current-ma = <0x5dc>;
						qcom,default-led-trigger = "flash2_trigger";
						qcom,id = <0x02>;
						qcom,duration-ms = <0x500>;
						qcom,ires-ua = <0x30d4>;
						phandle = <0x35>;
					};

					qcom,flash_3 {
						label = "flash";
						qcom,led-name = "led:flash_3";
						qcom,max-current-ma = <0x5dc>;
						qcom,default-led-trigger = "flash3_trigger";
						qcom,id = <0x03>;
						qcom,duration-ms = <0x500>;
						qcom,ires-ua = <0x30d4>;
						phandle = <0x36>;
					};

					qcom,torch_0 {
						label = "torch";
						qcom,led-name = "led:torch_0";
						qcom,max-current-ma = <0x1f4>;
						qcom,default-led-trigger = "torch0_trigger";
						qcom,id = <0x00>;
						qcom,ires-ua = <0x30d4>;
						phandle = <0x37>;
					};

					qcom,torch_1 {
						label = "torch";
						qcom,led-name = "led:torch_1";
						qcom,max-current-ma = <0x1f4>;
						qcom,default-led-trigger = "torch1_trigger";
						qcom,id = <0x01>;
						qcom,ires-ua = <0x30d4>;
						phandle = <0x38>;
					};

					qcom,torch_2 {
						label = "torch";
						qcom,led-name = "led:torch_2";
						qcom,max-current-ma = <0x1f4>;
						qcom,default-led-trigger = "torch2_trigger";
						qcom,id = <0x02>;
						qcom,ires-ua = <0x30d4>;
						phandle = <0x39>;
					};

					qcom,torch_3 {
						label = "torch";
						qcom,led-name = "led:torch_3";
						qcom,max-current-ma = <0x1f4>;
						qcom,default-led-trigger = "torch3_trigger";
						qcom,id = <0x03>;
						qcom,ires-ua = <0x30d4>;
						phandle = <0x3a>;
					};

					qcom,led_switch_0 {
						label = "switch";
						qcom,led-name = "led:switch_0";
						qcom,default-led-trigger = "switch0_trigger";
						qcom,led-mask = <0x09>;
						qcom,symmetry-en;
						phandle = <0x3b>;
					};

					qcom,led_switch_1 {
						label = "switch";
						qcom,led-name = "led:switch_1";
						qcom,default-led-trigger = "switch1_trigger";
						qcom,led-mask = <0x06>;
						qcom,symmetry-en;
						phandle = <0x3c>;
					};

					qcom,led_switch_2 {
						label = "switch";
						qcom,led-name = "led:switch_2";
						qcom,default-led-trigger = "switch2_trigger";
						qcom,led-mask = <0x0f>;
						qcom,symmetry-en;
						phandle = <0x3d>;
					};
				};
			};
		};
	};

	fragment@1 {
		target = <0xffffffff>;

		__overlay__ {

			pm8550_tz {
				polling-delay-passive = <0x64>;
				polling-delay = <0x00>;
				thermal-governor = "step_wise";
				thermal-sensors = <0x05>;
				phandle = <0x3e>;

				trips {

					trip0 {
						temperature = <0x17318>;
						hysteresis = <0x00>;
						type = "passive";
						phandle = <0x3f>;
					};

					trip1 {
						temperature = <0x1c138>;
						hysteresis = <0x00>;
						type = "passive";
						phandle = <0x40>;
					};

					trip2 {
						temperature = <0x23668>;
						hysteresis = <0x00>;
						type = "critical";
						phandle = <0x41>;
					};
				};
			};

			pm8550-bcl-lvl0 {
				polling-delay-passive = <0x64>;
				polling-delay = <0x00>;
				thermal-governor = "step_wise";
				thermal-sensors = <0x06 0x05>;

				trips {

					bcl-lvl0 {
						temperature = <0x01>;
						hysteresis = <0x01>;
						type = "passive";
						phandle = <0x1e>;
					};
				};
			};

			pm8550-bcl-lvl1 {
				polling-delay-passive = <0x64>;
				polling-delay = <0x00>;
				thermal-governor = "step_wise";
				thermal-sensors = <0x06 0x06>;

				trips {

					bcl-lvl1 {
						temperature = <0x01>;
						hysteresis = <0x01>;
						type = "passive";
						phandle = <0x1f>;
					};
				};
			};

			pm8550-bcl-lvl2 {
				polling-delay-passive = <0x64>;
				polling-delay = <0x00>;
				thermal-governor = "step_wise";
				thermal-sensors = <0x06 0x07>;

				trips {

					bcl-lvl2 {
						temperature = <0x01>;
						hysteresis = <0x01>;
						type = "passive";
						phandle = <0x20>;
					};
				};
			};
		};
	};

	fragment@2 {
		target = <0xffffffff>;

		__overlay__ {
			#address-cells = <0x02>;
			#size-cells = <0x00>;
			interrupt-controller;
			#interrupt-cells = <0x04>;

			qcom,pm8550b@7 {
				compatible = "qcom,spmi-pmic";
				reg = <0x07 0x00>;
				#address-cells = <0x01>;
				#size-cells = <0x00>;

				pm8550b-temp-alarm@a00 {
					compatible = "qcom,spmi-temp-alarm";
					reg = <0xa00>;
					interrupts = <0x07 0x0a 0x00 0x03>;
					#thermal-sensor-cells = <0x00>;
					io-channels = <0x01 0x703>;
					io-channel-names = "thermal";
					phandle = <0x08>;
				};

				pm8550b-temp-alarm-lite@c00 {
					compatible = "qcom,spmi-temp-alarm";
					reg = <0xc00>;
					interrupts = <0x07 0x0c 0x00 0x03>;
					#thermal-sensor-cells = <0x00>;
					io-channels = <0x01 0x718>;
					io-channel-names = "thermal";
					phandle = <0x09>;
				};

				pinctrl@8800 {
					compatible = "qcom,pm8550b-gpio";
					reg = <0x8800>;
					gpio-controller;
					#gpio-cells = <0x02>;
					interrupt-controller;
					#interrupt-cells = <0x02>;
					phandle = <0x42>;
				};

				qcom,hv-haptics@f000 {
					compatible = "qcom,hv-haptics";
					reg = <0xf000 0xf100 0xf200>;
					interrupts = <0x07 0xf0 0x01 0x01>;
					interrupt-names = "fifo-empty";
					qcom,vmax-mv = <0x514>;
					qcom,brake-mode = <0x01>;
					qcom,brake-pattern = [ff 3f 1f];
					qcom,lra-period-us = <0x16f8>;
					qcom,drv-sig-shape = <0x01>;
					qcom,brake-sig-shape = <0x01>;
					status = "ok";
					nvmem-names = "hap_cfg_sdam";
					nvmem = <0x07>;
					phandle = <0x43>;

					qcom,hap-swr-slave-reg {
						regulator-name = "hap-swr-slave-reg";
						phandle = <0x44>;
					};

					effect_0 {
						qcom,effect-id = <0x00>;
						qcom,wf-vmax-mv = <0x708>;
						qcom,wf-pattern-data = <0x1f 0x00 0x00 0x3f 0x00 0x00 0x5f 0x00 0x00 0x7f 0x00 0x00 0x17f 0x00 0x00 0x15f 0x00 0x00 0x13f 0x00 0x00 0x11f 0x00 0x00>;
						qcom,wf-pattern-period-us = <0x16f8>;
						qcom,wf-brake-pattern = [00 00 00];
						qcom,wf-pattern-preload;
						qcom,wf-auto-res-disable;
					};

					effect_1 {
						qcom,effect-id = <0x01>;
						qcom,wf-vmax-mv = <0x708>;
						qcom,wf-pattern-data = <0x1f 0x00 0x00 0x3f 0x00 0x00 0x5f 0x00 0x00 0x7f 0x00 0x00 0x17f 0x00 0x00 0x15f 0x00 0x00 0x13f 0x00 0x00 0x11f 0x00 0x00>;
						qcom,wf-pattern-period-us = <0x16f8>;
						qcom,wf-brake-pattern = [00 00 00];
						qcom,wf-auto-res-disable;
					};

					effect_2 {
						qcom,effect-id = <0x02>;
						qcom,wf-vmax-mv = <0x708>;
						qcom,wf-pattern-data = <0x1f 0x00 0x00 0x3f 0x00 0x00 0x5f 0x00 0x00 0x7f 0x00 0x00 0x17f 0x00 0x00 0x15f 0x00 0x00 0x13f 0x00 0x00 0x11f 0x00 0x00>;
						qcom,wf-pattern-period-us = <0x16f8>;
						qcom,wf-brake-pattern = [00 00 00];
						qcom,wf-auto-res-disable;
					};

					effect_3 {
						qcom,effect-id = <0x03>;
						qcom,wf-vmax-mv = <0x708>;
						qcom,wf-pattern-data = <0x1f 0x00 0x00 0x3f 0x00 0x00 0x5f 0x00 0x00 0x7f 0x00 0x00 0x17f 0x00 0x00 0x15f 0x00 0x00 0x13f 0x00 0x00 0x11f 0x00 0x00>;
						qcom,wf-pattern-period-us = <0x16f8>;
						qcom,wf-brake-pattern = [00 00 00];
						qcom,wf-auto-res-disable;
					};

					effect_4 {
						qcom,effect-id = <0x04>;
						qcom,wf-vmax-mv = <0x708>;
						qcom,wf-pattern-data = <0x1f 0x00 0x00 0x3f 0x00 0x00 0x5f 0x00 0x00 0x7f 0x00 0x00 0x17f 0x00 0x00 0x15f 0x00 0x00 0x13f 0x00 0x00 0x11f 0x00 0x00>;
						qcom,wf-pattern-period-us = <0x16f8>;
						qcom,wf-brake-pattern = [00 00 00];
						qcom,wf-auto-res-disable;
					};

					effect_5 {
						qcom,effect-id = <0x05>;
						qcom,wf-vmax-mv = <0x708>;
						qcom,wf-pattern-data = <0x1f 0x00 0x00 0x3f 0x00 0x00 0x5f 0x00 0x00 0x7f 0x00 0x00 0x17f 0x00 0x00 0x15f 0x00 0x00 0x13f 0x00 0x00 0x11f 0x00 0x00>;
						qcom,wf-pattern-period-us = <0x16f8>;
						qcom,wf-brake-pattern = [00 00 00];
						qcom,wf-auto-res-disable;
					};

					primitive_0 {
						qcom,primitive-id = <0x00>;
						qcom,wf-vmax-mv = <0x960>;
						qcom,wf-pattern-data = <0x00 0x00 0x00 0x00 0x00 0x00>;
						qcom,wf-pattern-period-us = <0x16f8>;
						qcom,wf-brake-pattern = [00 00 00];
						qcom,wf-auto-res-disable;
					};

					primitive_1 {
						qcom,primitive-id = <0x01>;
						qcom,wf-vmax-mv = <0x960>;
						qcom,wf-pattern-data = <0xff 0x00 0x00 0x7f 0x00 0x00>;
						qcom,wf-pattern-period-us = <0x16f8>;
						qcom,wf-brake-pattern = [00 00 00];
						qcom,wf-auto-res-disable;
					};

					primitive_2 {
						qcom,primitive-id = <0x02>;
						qcom,wf-vmax-mv = <0x960>;
						qcom,wf-pattern-data = <0xff 0x00 0x00 0x7f 0x00 0x00>;
						qcom,wf-pattern-period-us = <0x16f8>;
						qcom,wf-brake-pattern = [00 00 00];
						qcom,wf-auto-res-disable;
					};

					primitive_3 {
						qcom,primitive-id = <0x03>;
						qcom,wf-vmax-mv = <0x960>;
						qcom,wf-pattern-data = <0xff 0x00 0x00 0x7f 0x00 0x00>;
						qcom,wf-pattern-period-us = <0x16f8>;
						qcom,wf-brake-pattern = [00 00 00];
						qcom,wf-auto-res-disable;
					};

					primitive_4 {
						qcom,primitive-id = <0x04>;
						qcom,wf-vmax-mv = <0x960>;
						qcom,wf-pattern-data = <0xff 0x00 0x00 0x7f 0x00 0x00>;
						qcom,wf-pattern-period-us = <0x16f8>;
						qcom,wf-brake-pattern = [00 00 00];
						qcom,wf-auto-res-disable;
					};

					primitive_5 {
						qcom,primitive-id = <0x05>;
						qcom,wf-vmax-mv = <0x960>;
						qcom,wf-pattern-data = <0xff 0x00 0x00 0x7f 0x00 0x00>;
						qcom,wf-pattern-period-us = <0x16f8>;
						qcom,wf-brake-pattern = [00 00 00];
						qcom,wf-auto-res-disable;
					};

					primitive_6 {
						qcom,primitive-id = <0x06>;
						qcom,wf-vmax-mv = <0x960>;
						qcom,wf-pattern-data = <0xff 0x00 0x00 0x7f 0x00 0x00>;
						qcom,wf-pattern-period-us = <0x16f8>;
						qcom,wf-brake-pattern = [00 00 00];
						qcom,wf-auto-res-disable;
					};

					primitive_7 {
						qcom,primitive-id = <0x07>;
						qcom,wf-vmax-mv = <0x960>;
						qcom,wf-pattern-data = <0xff 0x00 0x00 0x7f 0x00 0x00>;
						qcom,wf-pattern-period-us = <0x16f8>;
						qcom,wf-brake-pattern = [00 00 00];
						qcom,wf-auto-res-disable;
					};

					primitive_8 {
						qcom,primitive-id = <0x08>;
						qcom,wf-vmax-mv = <0x960>;
						qcom,wf-pattern-data = <0xff 0x00 0x00 0x7f 0x00 0x00>;
						qcom,wf-pattern-period-us = <0x16f8>;
						qcom,wf-brake-pattern = [00 00 00];
						qcom,wf-auto-res-disable;
					};
				};

				bcl@4700 {
					compatible = "qcom,bcl-v5";
					reg = <0x4700 0x100>;
					interrupts = <0x07 0x47 0x00 0x00 0x07 0x47 0x01 0x00 0x07 0x47 0x02 0x00>;
					interrupt-names = "bcl-lvl0", "bcl-lvl1", "bcl-lvl2";
					qcom,pmic7-threshold;
					#thermal-sensor-cells = <0x01>;
					phandle = <0x0a>;
				};

				bcl-soc {
					compatible = "qcom,msm-bcl-soc";
					#thermal-sensor-cells = <0x00>;
					phandle = <0x45>;
				};

				qcom,eusb2-repeater@fd00 {
					compatible = "qcom,pmic-eusb2-repeater";
					reg = <0xfd00>;
					vdd18-supply = <0xffffffff>;
					vdd3-supply = <0xffffffff>;
					qcom,param-override-seq = <0x0f 0x51 0x03 0x54 0x07 0x57 0x06 0x53 0x02 0x59>;
					phandle = <0x2d>;
				};
			};
		};
	};

	fragment@3 {
		target = <0xffffffff>;

		__overlay__ {

			pm8550b_tz {
				polling-delay-passive = <0x64>;
				polling-delay = <0x00>;
				thermal-governor = "step_wise";
				thermal-sensors = <0x08>;
				phandle = <0x46>;

				trips {

					trip0 {
						temperature = <0x17318>;
						hysteresis = <0x00>;
						type = "passive";
						phandle = <0x47>;
					};

					trip1 {
						temperature = <0x1c138>;
						hysteresis = <0x00>;
						type = "passive";
						phandle = <0x48>;
					};

					trip2 {
						temperature = <0x23668>;
						hysteresis = <0x00>;
						type = "critical";
						phandle = <0x49>;
					};
				};
			};

			pm8550b_lite_tz {
				polling-delay-passive = <0x64>;
				polling-delay = <0x00>;
				thermal-governor = "step_wise";
				thermal-sensors = <0x09>;
				phandle = <0x4a>;

				trips {

					trip0 {
						temperature = <0x1e848>;
						hysteresis = <0x00>;
						type = "passive";
					};

					trip1 {
						temperature = <0x20f58>;
						hysteresis = <0x00>;
						type = "passive";
					};

					trip2 {
						temperature = <0x23668>;
						hysteresis = <0x00>;
						type = "critical";
					};
				};
			};

			pm8550b-ibat-lvl0 {
				polling-delay-passive = <0x00>;
				polling-delay = <0x00>;
				thermal-sensors = <0x0a 0x00>;

				trips {

					ibat-lvl0 {
						temperature = <0x2710>;
						hysteresis = <0xc8>;
						type = "passive";
						phandle = <0x4b>;
					};
				};
			};

			pm8550b-ibat-lvl1 {
				polling-delay-passive = <0x00>;
				polling-delay = <0x00>;
				thermal-sensors = <0x0a 0x01>;

				trips {

					ibat-lvl1 {
						temperature = <0x2cec>;
						hysteresis = <0xc8>;
						type = "passive";
						phandle = <0x4c>;
					};
				};
			};

			pm8550b-bcl-lvl0 {
				polling-delay-passive = <0x64>;
				polling-delay = <0x00>;
				thermal-sensors = <0x0a 0x05>;

				trips {

					thermal-engine-trip {
						temperature = <0x64>;
						hysteresis = <0x00>;
						type = "passive";
					};

					thermal-hal-trip {
						temperature = <0x64>;
						hysteresis = <0x00>;
						type = "passive";
					};

					b-bcl-lvl0 {
						temperature = <0x01>;
						hysteresis = <0x01>;
						type = "passive";
						phandle = <0x1b>;
					};
				};
			};

			pm8550b-bcl-lvl1 {
				polling-delay-passive = <0x64>;
				polling-delay = <0x00>;
				thermal-sensors = <0x0a 0x06>;

				trips {

					thermal-engine-trip {
						temperature = <0x64>;
						hysteresis = <0x00>;
						type = "passive";
					};

					thermal-hal-trip {
						temperature = <0x64>;
						hysteresis = <0x00>;
						type = "passive";
					};

					b-bcl-lvl1 {
						temperature = <0x01>;
						hysteresis = <0x01>;
						type = "passive";
						phandle = <0x1c>;
					};
				};
			};

			pm8550b-bcl-lvl2 {
				polling-delay-passive = <0x64>;
				polling-delay = <0x00>;
				thermal-sensors = <0x0a 0x07>;

				trips {

					thermal-engine-trip {
						temperature = <0x64>;
						hysteresis = <0x00>;
						type = "passive";
					};

					thermal-hal-trip {
						temperature = <0x64>;
						hysteresis = <0x00>;
						type = "passive";
					};

					b-bcl-lvl2 {
						temperature = <0x01>;
						hysteresis = <0x01>;
						type = "passive";
						phandle = <0x1d>;
					};
				};
			};

			socd {
				polling-delay-passive = <0x64>;
				polling-delay = <0x00>;

				trips {

					thermal-engine-trip {
						temperature = <0x64>;
						hysteresis = <0x00>;
						type = "passive";
					};

					thermal-hal-trip {
						temperature = <0x64>;
						hysteresis = <0x00>;
						type = "passive";
					};

					socd-trip {
						temperature = <0x5a>;
						hysteresis = <0x00>;
						type = "passive";
						phandle = <0x1a>;
					};
				};
			};
		};
	};

	fragment@4 {
		target = <0xffffffff>;

		__overlay__ {
			#address-cells = <0x02>;
			#size-cells = <0x00>;
			interrupt-controller;
			#interrupt-cells = <0x04>;

			qcom,pm8550ve_f@5 {
				compatible = "qcom,spmi-pmic";
				reg = <0x05 0x00>;
				#address-cells = <0x01>;
				#size-cells = <0x00>;

				pm8550ve-f-temp-alarm@a00 {
					compatible = "qcom,spmi-temp-alarm";
					reg = <0xa00>;
					interrupts = <0x05 0x0a 0x00 0x03>;
					#thermal-sensor-cells = <0x00>;
					io-channels = <0x01 0x503>;
					io-channel-names = "thermal";
					phandle = <0x0b>;
				};

				pinctrl@8800 {
					compatible = "qcom,pm8550ve-gpio";
					reg = <0x8800>;
					gpio-controller;
					#gpio-cells = <0x02>;
					interrupt-controller;
					#interrupt-cells = <0x02>;
					phandle = <0x4d>;
				};
			};
		};
	};

	fragment@5 {
		target = <0xffffffff>;

		__overlay__ {

			pm8550ve_f_tz {
				polling-delay-passive = <0x64>;
				polling-delay = <0x00>;
				thermal-governor = "step_wise";
				thermal-sensors = <0x0b>;
				phandle = <0x4e>;

				trips {

					trip0 {
						temperature = <0x17318>;
						hysteresis = <0x00>;
						type = "passive";
						phandle = <0x23>;
					};

					trip1 {
						temperature = <0x1c138>;
						hysteresis = <0x00>;
						type = "passive";
						phandle = <0x4f>;
					};

					trip2 {
						temperature = <0x23668>;
						hysteresis = <0x00>;
						type = "critical";
						phandle = <0x50>;
					};
				};
			};
		};
	};

	fragment@6 {
		target = <0xffffffff>;

		__overlay__ {
			#address-cells = <0x02>;
			#size-cells = <0x00>;
			interrupt-controller;
			#interrupt-cells = <0x04>;

			qcom,pm8550vs@2 {
				compatible = "qcom,spmi-pmic";
				reg = <0x02 0x00>;
				#address-cells = <0x01>;
				#size-cells = <0x00>;
				phandle = <0x51>;

				pm8550vs-c-temp-alarm@a00 {
					compatible = "qcom,spmi-temp-alarm";
					reg = <0xa00>;
					interrupts = <0x02 0x0a 0x00 0x03>;
					#thermal-sensor-cells = <0x00>;
					io-channels = <0x01 0x203>;
					io-channel-names = "thermal";
					phandle = <0x0c>;
				};

				pinctrl@8800 {
					compatible = "qcom,pm8550vs-gpio";
					reg = <0x8800>;
					gpio-controller;
					#gpio-cells = <0x02>;
					interrupt-controller;
					#interrupt-cells = <0x02>;
					phandle = <0x52>;
				};
			};

			qcom,pm8550vs@3 {
				compatible = "qcom,spmi-pmic";
				reg = <0x03 0x00>;
				#address-cells = <0x01>;
				#size-cells = <0x00>;
				status = "ok";
				phandle = <0x53>;

				pm8550vs-d-temp-alarm@a00 {
					compatible = "qcom,spmi-temp-alarm";
					reg = <0xa00>;
					interrupts = <0x03 0x0a 0x00 0x03>;
					#thermal-sensor-cells = <0x00>;
					io-channels = <0x01 0x303>;
					io-channel-names = "thermal";
					phandle = <0x0d>;
				};

				pinctrl@8800 {
					compatible = "qcom,pm8550vs-gpio";
					reg = <0x8800>;
					gpio-controller;
					#gpio-cells = <0x02>;
					interrupt-controller;
					#interrupt-cells = <0x02>;
					phandle = <0x54>;

					eusb2_repeater_reset {

						eusb2_repeater_reset_default {
							pins = "gpio4";
							function = "normal";
							input-enable;
							output-enable;
							bias-disable;
							power-source = <0x01>;
							qcom,drive-strength = <0x02>;
							phandle = <0x55>;
						};
					};
				};
			};

			qcom,pm8550vs@4 {
				compatible = "qcom,spmi-pmic";
				reg = <0x04 0x00>;
				#address-cells = <0x01>;
				#size-cells = <0x00>;
				status = "ok";
				phandle = <0x56>;

				pm8550vs-e-temp-alarm@a00 {
					compatible = "qcom,spmi-temp-alarm";
					reg = <0xa00>;
					interrupts = <0x04 0x0a 0x00 0x03>;
					#thermal-sensor-cells = <0x00>;
					io-channels = <0x01 0x403>;
					io-channel-names = "thermal";
					phandle = <0x0e>;
				};

				pinctrl@8800 {
					compatible = "qcom,pm8550vs-gpio";
					reg = <0x8800>;
					gpio-controller;
					#gpio-cells = <0x02>;
					interrupt-controller;
					#interrupt-cells = <0x02>;
					phandle = <0x57>;
				};
			};

			qcom,pm8550vs@6 {
				compatible = "qcom,spmi-pmic";
				reg = <0x06 0x00>;
				#address-cells = <0x01>;
				#size-cells = <0x00>;
				status = "ok";
				phandle = <0x58>;

				pm8550vs-g-temp-alarm@a00 {
					compatible = "qcom,spmi-temp-alarm";
					reg = <0xa00>;
					interrupts = <0x06 0x0a 0x00 0x03>;
					#thermal-sensor-cells = <0x00>;
					io-channels = <0x01 0x603>;
					io-channel-names = "thermal";
					phandle = <0x0f>;
				};

				pinctrl@8800 {
					compatible = "qcom,pm8550vs-gpio";
					reg = <0x8800>;
					gpio-controller;
					#gpio-cells = <0x02>;
					interrupt-controller;
					#interrupt-cells = <0x02>;
					phandle = <0x59>;
				};
			};
		};
	};

	fragment@7 {
		target = <0xffffffff>;

		__overlay__ {

			pm8550vs_c_tz {
				polling-delay-passive = <0x64>;
				polling-delay = <0x00>;
				thermal-governor = "step_wise";
				thermal-sensors = <0x0c>;
				phandle = <0x5a>;

				trips {

					trip0 {
						temperature = <0x17318>;
						hysteresis = <0x00>;
						type = "passive";
						phandle = <0x21>;
					};

					trip1 {
						temperature = <0x1c138>;
						hysteresis = <0x00>;
						type = "passive";
						phandle = <0x5b>;
					};

					trip2 {
						temperature = <0x23668>;
						hysteresis = <0x00>;
						type = "critical";
						phandle = <0x5c>;
					};
				};
			};

			pm8550vs_d_tz {
				polling-delay-passive = <0x64>;
				polling-delay = <0x00>;
				thermal-governor = "step_wise";
				thermal-sensors = <0x0d>;
				status = "ok";
				phandle = <0x5d>;

				trips {

					trip0 {
						temperature = <0x17318>;
						hysteresis = <0x00>;
						type = "passive";
						phandle = <0x22>;
					};

					trip1 {
						temperature = <0x1c138>;
						hysteresis = <0x00>;
						type = "passive";
						phandle = <0x5e>;
					};

					trip2 {
						temperature = <0x23668>;
						hysteresis = <0x00>;
						type = "critical";
						phandle = <0x5f>;
					};
				};
			};

			pm8550vs_e_tz {
				polling-delay-passive = <0x64>;
				polling-delay = <0x00>;
				thermal-governor = "step_wise";
				thermal-sensors = <0x0e>;
				status = "ok";
				phandle = <0x60>;

				trips {

					trip0 {
						temperature = <0x17318>;
						hysteresis = <0x00>;
						type = "passive";
						phandle = <0x61>;
					};

					trip1 {
						temperature = <0x1c138>;
						hysteresis = <0x00>;
						type = "passive";
						phandle = <0x62>;
					};

					trip2 {
						temperature = <0x23668>;
						hysteresis = <0x00>;
						type = "critical";
						phandle = <0x63>;
					};
				};
			};

			pm8550vs_g_tz {
				polling-delay-passive = <0x64>;
				polling-delay = <0x00>;
				thermal-governor = "step_wise";
				thermal-sensors = <0x0f>;
				status = "ok";
				phandle = <0x64>;

				trips {

					trip0 {
						temperature = <0x17318>;
						hysteresis = <0x00>;
						type = "passive";
						phandle = <0x65>;
					};

					trip1 {
						temperature = <0x1c138>;
						hysteresis = <0x00>;
						type = "passive";
						phandle = <0x66>;
					};

					trip2 {
						temperature = <0x23668>;
						hysteresis = <0x00>;
						type = "critical";
						phandle = <0x67>;
					};
				};
			};
		};
	};

	fragment@8 {
		target = <0xffffffff>;

		__overlay__ {
			#address-cells = <0x02>;
			#size-cells = <0x00>;
			interrupt-controller;
			#interrupt-cells = <0x04>;

			qcom,pmk8550@0 {
				compatible = "qcom,spmi-pmic";
				reg = <0x00 0x00>;
				#address-cells = <0x01>;
				#size-cells = <0x00>;

				pon_hlos@1300 {
					compatible = "qcom,pm8998-pon";
					reg = <0x1300 0x800>;
					reg-names = "pon_hlos", "pon_pbs";

					pwrkey {
						compatible = "qcom,pmk8350-pwrkey";
						interrupts = <0x00 0x13 0x07 0x03>;
						linux,code = <0x74>;
					};

					resin {
						compatible = "qcom,pmk8350-resin";
						interrupts = <0x00 0x13 0x06 0x03>;
						linux,code = <0x72>;
					};

					pwrkey-resin-bark {
						compatible = "qcom,pmk8350-pwrkey-resin-bark";
						interrupts = <0x00 0x13 0x02 0x03>;
						linux,code = <0x74>;
					};

					pwrkey-bark {
						compatible = "qcom,pmk8350-pwrkey-bark";
						interrupts = <0x00 0x13 0x00 0x03>;
						linux,code = <0x74>;
					};
				};

				sdam@7000 {
					compatible = "qcom,spmi-sdam";
					reg = <0x7000>;
					#address-cells = <0x01>;
					#size-cells = <0x01>;
					phandle = <0x68>;

					ocp-log@76 {
						reg = <0x76 0x06>;
						phandle = <0x19>;
					};
				};

				sdam@7100 {
					compatible = "qcom,spmi-sdam";
					reg = <0x7100>;
					#address-cells = <0x01>;
					#size-cells = <0x01>;
					phandle = <0x69>;

					restart@48 {
						reg = <0x48 0x01>;
						bits = <0x01 0x07>;
						phandle = <0x15>;
					};
				};

				sdam@7400 {
					compatible = "qcom,spmi-sdam";
					reg = <0x7400>;
					phandle = <0x17>;
				};

				sdam@7500 {
					compatible = "qcom,spmi-sdam";
					reg = <0x7500>;
					phandle = <0x18>;
				};

				sdam@8400 {
					compatible = "qcom,spmi-sdam";
					reg = <0x8400>;
					phandle = <0x02>;
				};

				sdam@8500 {
					compatible = "qcom,spmi-sdam";
					reg = <0x8500>;
					phandle = <0x03>;
				};

				sdam@9d00 {
					compatible = "qcom,spmi-sdam";
					reg = <0x9d00>;
					phandle = <0x07>;
				};

				pinctrl@b800 {
					compatible = "qcom,pmk8550-gpio";
					reg = <0xb800>;
					gpio-controller;
					#gpio-cells = <0x02>;
					interrupt-controller;
					#interrupt-cells = <0x02>;
					pinctrl-0 = <0x10>;
					pinctrl-names = "default";
					phandle = <0x6a>;

					alt_sleep_clk {

						alt_sleep_clk_default {
							pins = "gpio3";
							function = "func1";
							input-disable;
							output-enable;
							bias-disable;
							power-source = <0x00>;
							phandle = <0x10>;
						};
					};
				};

				rtc@6100 {
					compatible = "qcom,pmk8350-rtc";
					reg = <0x6100 0x6200>;
					reg-names = "rtc", "alarm";
					interrupts = <0x00 0x62 0x01 0x01>;
					phandle = <0x6b>;
				};

				vadc@9000 {
					compatible = "qcom,spmi-adc5-gen3";
					reg = <0x9000 0x9100>;
					#address-cells = <0x01>;
					#size-cells = <0x00>;
					interrupt-names = "adc-sdam0", "adc-sdam1";
					interrupts = <0x00 0x90 0x01 0x01 0x00 0x91 0x01 0x01>;
					#thermal-sensor-cells = <0x01>;
					#io-channel-cells = <0x01>;
					io-channel-ranges;
					phandle = <0x01>;

					pmk8550_offset_ref {
						reg = <0x00>;
						label = "pmk8550_offset_ref";
						qcom,pre-scaling = <0x01 0x01>;
					};

					pmk8550_vref_1p25 {
						reg = <0x01>;
						label = "pmk8550_vref_1p25";
						qcom,pre-scaling = <0x01 0x01>;
					};

					pmk8550_die_temp {
						reg = <0x03>;
						label = "pmk8550_die_temp";
						qcom,pre-scaling = <0x01 0x01>;
					};

					pmk8550_xo_therm {
						reg = <0x44>;
						label = "pmk8550_xo_therm";
						qcom,ratiometric;
						qcom,hw-settle-time = <0xc8>;
						qcom,pre-scaling = <0x01 0x01>;
						qcom,adc-tm-type = <0x01>;
					};

					pm8550_offset_ref {
						reg = <0x100>;
						label = "pm8550_offset_ref";
						qcom,pre-scaling = <0x01 0x01>;
					};

					pm8550_vref_1p25 {
						reg = <0x101>;
						label = "pm8550_vref_1p25";
						qcom,pre-scaling = <0x01 0x01>;
					};

					pm8550_die_temp {
						reg = <0x103>;
						label = "pm8550_die_temp";
						qcom,pre-scaling = <0x01 0x01>;
					};

					pm8550_vph_pwr {
						reg = <0x18e>;
						label = "pm8550_vph_pwr";
						qcom,pre-scaling = <0x01 0x03>;
					};

					pm8550b_offset_ref {
						reg = <0x700>;
						label = "pm8550b_offset_ref";
						qcom,pre-scaling = <0x01 0x01>;
					};

					pm8550b_vref_1p25 {
						reg = <0x701>;
						label = "pm8550b_vref_1p25";
						qcom,pre-scaling = <0x01 0x01>;
					};

					pm8550b_die_temp {
						reg = <0x703>;
						label = "pm8550b_die_temp";
						qcom,pre-scaling = <0x01 0x01>;
					};

					pm8550b_lite_die_temp {
						reg = <0x718>;
						label = "pm8550b_lite_die_temp";
						qcom,pre-scaling = <0x01 0x01>;
					};

					pm8550b_vph_pwr {
						reg = <0x78e>;
						label = "pm8550b_vph_pwr";
						qcom,pre-scaling = <0x01 0x03>;
					};

					pm8550b_vbat_sns_qbg {
						reg = <0x78f>;
						label = "pm8550b_vbat_sns_qbg";
						qcom,pre-scaling = <0x01 0x03>;
					};

					pm8550vs_c_die_temp {
						reg = <0x203>;
						label = "pm8550vs_c_die_temp";
						qcom,pre-scaling = <0x01 0x01>;
					};

					pm8550vs_d_die_temp {
						reg = <0x303>;
						label = "pm8550vs_d_die_temp";
						qcom,pre-scaling = <0x01 0x01>;
					};

					pm8550vs_e_die_temp {
						reg = <0x403>;
						label = "pm8550vs_e_die_temp";
						qcom,pre-scaling = <0x01 0x01>;
					};

					pm8550vs_g_die_temp {
						reg = <0x603>;
						label = "pm8550vs_g_die_temp";
						qcom,pre-scaling = <0x01 0x01>;
					};

					pm8550ve_die_temp {
						reg = <0x503>;
						label = "pm8550ve_die_temp";
						qcom,pre-scaling = <0x01 0x01>;
					};
				};
			};
		};
	};

	fragment@9 {
		target = <0xffffffff>;

		__overlay__ {
			#address-cells = <0x02>;
			#size-cells = <0x00>;
			interrupt-controller;
			#interrupt-cells = <0x04>;

			qcom,pmr735d@a {
				compatible = "qcom,spmi-pmic";
				reg = <0x0a 0x00>;
				#address-cells = <0x01>;
				#size-cells = <0x00>;

				pmr735d-k-temp-alarm@a00 {
					compatible = "qcom,spmi-temp-alarm";
					reg = <0xa00>;
					interrupts = <0x0a 0x0a 0x00 0x03>;
					#thermal-sensor-cells = <0x00>;
					phandle = <0x11>;
				};

				pinctrl@8800 {
					compatible = "qcom,pmr735d-gpio";
					reg = <0x8800>;
					gpio-controller;
					#gpio-cells = <0x02>;
					interrupt-controller;
					#interrupt-cells = <0x02>;
					phandle = <0x6c>;
				};
			};

			qcom,pmr735d@b {
				compatible = "qcom,spmi-pmic";
				reg = <0x0b 0x00>;
				#address-cells = <0x01>;
				#size-cells = <0x00>;

				pmr735d-l-temp-alarm@a00 {
					compatible = "qcom,spmi-temp-alarm";
					reg = <0xa00>;
					interrupts = <0x0b 0x0a 0x00 0x03>;
					#thermal-sensor-cells = <0x00>;
					phandle = <0x12>;
				};

				pinctrl@8800 {
					compatible = "qcom,pmr735d-gpio";
					reg = <0x8800>;
					gpio-controller;
					#gpio-cells = <0x02>;
					interrupt-controller;
					#interrupt-cells = <0x02>;
					phandle = <0x6d>;
				};
			};
		};
	};

	fragment@10 {
		target = <0xffffffff>;

		__overlay__ {

			pmr735d_k_tz {
				polling-delay-passive = <0x64>;
				polling-delay = <0x00>;
				thermal-governor = "step_wise";
				thermal-sensors = <0x11>;
				phandle = <0x6e>;

				trips {

					trip0 {
						temperature = <0x17318>;
						hysteresis = <0x00>;
						type = "passive";
						phandle = <0x6f>;
					};

					trip1 {
						temperature = <0x1c138>;
						hysteresis = <0x00>;
						type = "passive";
						phandle = <0x70>;
					};

					trip2 {
						temperature = <0x23668>;
						hysteresis = <0x00>;
						type = "critical";
						phandle = <0x71>;
					};
				};
			};

			pmr735d_l_tz {
				polling-delay-passive = <0x64>;
				polling-delay = <0x00>;
				thermal-governor = "step_wise";
				thermal-sensors = <0x12>;
				phandle = <0x72>;

				trips {

					trip0 {
						temperature = <0x17318>;
						hysteresis = <0x00>;
						type = "passive";
						phandle = <0x73>;
					};

					trip1 {
						temperature = <0x1c138>;
						hysteresis = <0x00>;
						type = "passive";
						phandle = <0x74>;
					};

					trip2 {
						temperature = <0x23668>;
						hysteresis = <0x00>;
						type = "critical";
						phandle = <0x75>;
					};
				};
			};
		};
	};

	fragment@11 {
		target = <0xffffffff>;

		__overlay__ {
			#address-cells = <0x02>;
			#size-cells = <0x00>;
			interrupt-controller;
			#interrupt-cells = <0x04>;

			qcom,pm8010@c {
				compatible = "qcom,spmi-pmic";
				reg = <0x0c 0x00>;
				#address-cells = <0x01>;
				#size-cells = <0x00>;
				phandle = <0x76>;

				pm8010-m-temp-alarm@2400 {
					compatible = "qcom,spmi-temp-alarm";
					reg = <0x2400>;
					interrupts = <0x0c 0x24 0x00 0x03>;
					#thermal-sensor-cells = <0x00>;
					phandle = <0x13>;
				};
			};

			qcom,pm8010@d {
				compatible = "qcom,spmi-pmic";
				reg = <0x0d 0x00>;
				#address-cells = <0x01>;
				#size-cells = <0x00>;
				phandle = <0x77>;

				pm8010-n-temp-alarm@2400 {
					compatible = "qcom,spmi-temp-alarm";
					reg = <0x2400>;
					interrupts = <0x0d 0x24 0x00 0x03>;
					#thermal-sensor-cells = <0x00>;
					phandle = <0x14>;
				};
			};
		};
	};

	fragment@12 {
		target = <0xffffffff>;

		__overlay__ {

			pm8010m_tz {
				polling-delay-passive = <0x64>;
				polling-delay = <0x00>;
				thermal-governor = "step_wise";
				thermal-sensors = <0x13>;

				trips {

					trip0 {
						temperature = <0x17318>;
						hysteresis = <0x00>;
						type = "passive";
					};

					trip1 {
						temperature = <0x1c138>;
						hysteresis = <0x00>;
						type = "passive";
					};

					trip2 {
						temperature = <0x23668>;
						hysteresis = <0x00>;
						type = "critical";
					};
				};
			};

			pm8010n_tz {
				polling-delay-passive = <0x64>;
				polling-delay = <0x00>;
				thermal-governor = "step_wise";
				thermal-sensors = <0x14>;

				trips {

					trip0 {
						temperature = <0x17318>;
						hysteresis = <0x00>;
						type = "passive";
					};

					trip1 {
						temperature = <0x1c138>;
						hysteresis = <0x00>;
						type = "passive";
					};

					trip2 {
						temperature = <0x23668>;
						hysteresis = <0x00>;
						type = "critical";
					};
				};
			};

			xo-therm {
				polling-delay-passive = <0x00>;
				polling-delay = <0x00>;
				thermal-sensors = <0x01 0x44>;

				trips {

					active-config0 {
						temperature = <0x1e848>;
						hysteresis = <0x3e8>;
						type = "passive";
					};

					active-config1 {
						temperature = <0x1e848>;
						hysteresis = <0x3e8>;
						type = "passive";
					};

					xo-config0 {
						temperature = <0x130b0>;
						hysteresis = <0x1f40>;
						type = "passive";
						phandle = <0x24>;
					};

					xo-config1 {
						temperature = <0x13880>;
						hysteresis = <0x2710>;
						type = "passive";
						phandle = <0x25>;
					};

					display-test-config1 {
						temperature = <0x1e848>;
						hysteresis = <0x3e8>;
						type = "passive";
						phandle = <0x26>;
					};

					display-test-config2 {
						temperature = <0x1e848>;
						hysteresis = <0x3e8>;
						type = "passive";
						phandle = <0x27>;
					};

					display-test-config3 {
						temperature = <0x1e848>;
						hysteresis = <0x3e8>;
						type = "passive";
						phandle = <0x28>;
					};

					display-test-config4 {
						temperature = <0x1e848>;
						hysteresis = <0x3e8>;
						type = "passive";
						phandle = <0x29>;
					};
				};
			};
		};
	};

	fragment@13 {
		target = <0xffffffff>;

		__overlay__ {

			reboot_reason {
				compatible = "qcom,reboot-reason";
				nvmem-cells = <0x15>;
				nvmem-cell-names = "restart_reason";
			};

			regulator-dbo3 {
				compatible = "qti-regulator-fixed";
				regulator-name = "dbo3";
				regulator-min-microvolt = <0x36ee80>;
				regulator-max-microvolt = <0x36ee80>;
				gpio = <0x16 0x09 0x00>;
				regulator-enable-ramp-delay = <0x5dc>;
				enable-active-high;
				phandle = <0x78>;
			};

			pmic-pon-log {
				compatible = "qcom,pmic-pon-log";
				nvmem = <0x17 0x18>;
				nvmem-names = "pon_log0", "pon_log1";
			};

			regulator-ocp-notifier {
				compatible = "qcom,regulator-ocp-notifier";
				interrupt-parent = <0xffffffff>;
				interrupts = <0x00 0x71 0x01 0x01>;
				nvmem-cells = <0x19>;
				nvmem-cell-names = "ocp_log";
				periph-1c1-supply = <0xffffffff>;
				periph-1c2-supply = <0xffffffff>;
				periph-1c5-supply = <0xffffffff>;
				periph-1c6-supply = <0xffffffff>;
				periph-1c7-supply = <0xffffffff>;
				periph-1c8-supply = <0xffffffff>;
				periph-1c9-supply = <0xffffffff>;
				periph-1ca-supply = <0xffffffff>;
				periph-1cb-supply = <0xffffffff>;
				periph-1cc-supply = <0xffffffff>;
				periph-1cd-supply = <0xffffffff>;
				periph-1ce-supply = <0xffffffff>;
				periph-1cf-supply = <0xffffffff>;
				periph-1d0-supply = <0xffffffff>;
				periph-1d1-supply = <0xffffffff>;
				periph-2c1-supply = <0xffffffff>;
				periph-2c3-supply = <0xffffffff>;
				periph-3c1-supply = <0xffffffff>;
				periph-3c2-supply = <0xffffffff>;
				periph-4c1-supply = <0xffffffff>;
				periph-4c2-supply = <0xffffffff>;
				periph-4c3-supply = <0xffffffff>;
				periph-5c1-supply = <0xffffffff>;
				periph-5c2-supply = <0xffffffff>;
				periph-5c3-supply = <0xffffffff>;
				periph-6c1-supply = <0xffffffff>;
				periph-6c2-supply = <0xffffffff>;
				periph-6c3-supply = <0xffffffff>;
				periph-ac1-supply = <0xffffffff>;
				periph-ac2-supply = <0xffffffff>;
				periph-ac3-supply = <0xffffffff>;
				periph-ac4-supply = <0xffffffff>;
				periph-ac5-supply = <0xffffffff>;
				periph-ac6-supply = <0xffffffff>;
				periph-ac7-supply = <0xffffffff>;
				periph-bc3-supply = <0xffffffff>;
				periph-bc4-supply = <0xffffffff>;
				periph-bc5-supply = <0xffffffff>;
				periph-bc6-supply = <0xffffffff>;
				periph-bc7-supply = <0xffffffff>;
				periph-c40-supply = <0xffffffff>;
				periph-c41-supply = <0xffffffff>;
				periph-c42-supply = <0xffffffff>;
				periph-c43-supply = <0xffffffff>;
				periph-c44-supply = <0xffffffff>;
				periph-c45-supply = <0xffffffff>;
				periph-c46-supply = <0xffffffff>;
				periph-d40-supply = <0xffffffff>;
				periph-d41-supply = <0xffffffff>;
				periph-d42-supply = <0xffffffff>;
				periph-d43-supply = <0xffffffff>;
				periph-d44-supply = <0xffffffff>;
				periph-d45-supply = <0xffffffff>;
				periph-d46-supply = <0xffffffff>;
				phandle = <0x79>;
			};
		};
	};

	fragment@14 {
		target = <0xffffffff>;

		__overlay__ {

			socd {

				cooling-maps {

					socd_apc1 {
						trip = <0x1a>;
						cooling-device = <0xffffffff 0x01 0x01>;
					};

					socd_cdsp1 {
						trip = <0x1a>;
						cooling-device = <0xffffffff 0x04 0x04>;
					};

					socd_gpu0 {
						trip = <0x1a>;
						cooling-device = <0xffffffff 0x04 0x04>;
					};
				};
			};

			pm8550b-bcl-lvl0 {

				cooling-maps {

					lbat_0_mdm_lte {
						trip = <0x1b>;
						cooling-device = <0xffffffff 0x08 0x08>;
					};

					lbat_0_nr_scg {
						trip = <0x1b>;
						cooling-device = <0xffffffff 0x03 0x03>;
					};

					lbat_0_nr {
						trip = <0x1b>;
						cooling-device = <0xffffffff 0x06 0x06>;
					};

					lbat_cpu_3_4_5 {
						trip = <0x1b>;
						cooling-device = <0xffffffff 0x01 0x01>;
					};

					lbat_cdsp0 {
						trip = <0x1b>;
						cooling-device = <0xffffffff 0x02 0x02>;
					};

					lbat_gpu0 {
						trip = <0x1b>;
						cooling-device = <0xffffffff 0x02 0x02>;
					};
				};
			};

			pm8550b-bcl-lvl1 {

				cooling-maps {

					lbat_1_mdm_lte {
						trip = <0x1c>;
						cooling-device = <0xffffffff 0x0a 0x0a>;
					};

					lbat_1_nr_scg {
						trip = <0x1c>;
						cooling-device = <0xffffffff 0x0a 0x0a>;
					};

					lbat_1_nr {
						trip = <0x1c>;
						cooling-device = <0xffffffff 0x09 0x09>;
					};

					lbat_cpu_6_7 {
						trip = <0x1c>;
						cooling-device = <0xffffffff 0x01 0x01>;
					};

					lbat_cdsp1 {
						trip = <0x1c>;
						cooling-device = <0xffffffff 0x04 0x04>;
					};

					lbat_gpu1 {
						trip = <0x1c>;
						cooling-device = <0xffffffff 0x04 0x04>;
					};
				};
			};

			pm8550b-bcl-lvl2 {

				cooling-maps {

					lbat_cdsp2 {
						trip = <0x1d>;
						cooling-device = <0xffffffff 0x05 0xffffffff>;
					};

					lbat_gpu2 {
						trip = <0x1d>;
						cooling-device = <0xffffffff 0x05 0xffffffff>;
					};
				};
			};

			pm8550-bcl-lvl0 {

				cooling-maps {

					vph_lte0 {
						trip = <0x1e>;
						cooling-device = <0xffffffff 0x08 0x08>;
					};

					vph_nr0_scg {
						trip = <0x1e>;
						cooling-device = <0xffffffff 0x03 0x03>;
					};

					vph_nr0 {
						trip = <0x1e>;
						cooling-device = <0xffffffff 0x06 0x06>;
					};

					vph_cpu_3_4_5 {
						trip = <0x1e>;
						cooling-device = <0xffffffff 0x01 0x01>;
					};

					vph_cdsp0 {
						trip = <0x1e>;
						cooling-device = <0xffffffff 0x02 0x02>;
					};

					vph_gpu0 {
						trip = <0x1e>;
						cooling-device = <0xffffffff 0x02 0x02>;
					};
				};
			};

			pm8550-bcl-lvl1 {

				cooling-maps {

					vph_lte1 {
						trip = <0x1f>;
						cooling-device = <0xffffffff 0x0a 0x0a>;
					};

					vph_nr1_scg {
						trip = <0x1f>;
						cooling-device = <0xffffffff 0x0a 0x0a>;
					};

					vph_nr1 {
						trip = <0x1f>;
						cooling-device = <0xffffffff 0x09 0x09>;
					};

					vph_cpu_6_7 {
						trip = <0x1f>;
						cooling-device = <0xffffffff 0x01 0x01>;
					};

					vph_cdsp1 {
						trip = <0x1f>;
						cooling-device = <0xffffffff 0x04 0x04>;
					};

					vph_gpu1 {
						trip = <0x1f>;
						cooling-device = <0xffffffff 0x04 0x04>;
					};
				};
			};

			pm8550-bcl-lvl2 {

				cooling-maps {

					vph_cdsp2 {
						trip = <0x20>;
						cooling-device = <0xffffffff 0x05 0xffffffff>;
					};

					vph_gpu2 {
						trip = <0x20>;
						cooling-device = <0xffffffff 0x05 0xffffffff>;
					};
				};
			};

			pm8550vs_c_tz {

				cooling-maps {

					pm8550vs_c_apc1 {
						trip = <0x21>;
						cooling-device = <0xffffffff 0x01 0x01>;
					};
				};
			};

			pm8550vs_d_tz {

				cooling-maps {

					pm8550vs_d_gpu {
						trip = <0x22>;
						cooling-device = <0xffffffff 0x05 0xffffffff>;
					};
				};
			};

			pm8550ve_f_tz {

				cooling-maps {

					pm8550vs_e_nsp {
						trip = <0x23>;
						cooling-device = <0xffffffff 0x05 0xffffffff>;
					};

					pm8550vs_e_lte {
						trip = <0x23>;
						cooling-device = <0xffffffff 0xff 0xff>;
					};

					pm8550vs_e_nr {
						trip = <0x23>;
						cooling-device = <0xffffffff 0xff 0xff>;
					};
				};
			};

			xo-therm {

				cooling-maps {

					apc1_cdev {
						trip = <0x24>;
						cooling-device = <0xffffffff 0x01 0x01>;
					};

					cdsp_cdev {
						trip = <0x24>;
						cooling-device = <0xffffffff 0x05 0xffffffff>;
					};

					gpu_cdev {
						trip = <0x24>;
						cooling-device = <0xffffffff 0x05 0xffffffff>;
					};

					cpu3_hot_cdev {
						trip = <0x25>;
						cooling-device = <0xffffffff 0x01 0x01>;
					};

					cpu4_hot_cdev {
						trip = <0x25>;
						cooling-device = <0xffffffff 0x01 0x01>;
					};

					cpu5_hot_cdev {
						trip = <0x25>;
						cooling-device = <0xffffffff 0x01 0x01>;
					};

					cpu6_hot_cdev {
						trip = <0x25>;
						cooling-device = <0xffffffff 0x01 0x01>;
					};

					cpu7_hot_cdev {
						trip = <0x25>;
						cooling-device = <0xffffffff 0x01 0x01>;
					};

					lte_cdev {
						trip = <0x25>;
						cooling-device = <0xffffffff 0xff 0xff>;
					};

					nr_cdev {
						trip = <0x25>;
						cooling-device = <0xffffffff 0xff 0xff>;
					};

					display_cdev1 {
						trip = <0x26>;
						cooling-device = <0xffffffff 0x01 0x01>;
					};

					display_cdev2 {
						trip = <0x27>;
						cooling-device = <0xffffffff 0x02 0x02>;
					};

					display_cdev3 {
						trip = <0x28>;
						cooling-device = <0xffffffff 0x03 0x03>;
					};

					display_cdev4 {
						trip = <0x29>;
						cooling-device = <0xffffffff 0x04 0x04>;
					};
				};
			};
		};
	};

	fragment@15 {
		target = <0xffffffff>;

		__overlay__ {
			status = "ok";
			vdd-supply = <0xffffffff>;
			qcom,vdd-voltage-level = <0x2d0370 0x2d2a80>;
			qcom,vdd-current-level = <0x00 0xc3500>;
			vdd-io-supply = <0xffffffff>;
			qcom,vdd-io-voltage-level = <0x1b7740 0x2d2a80>;
			qcom,vdd-io-current-level = <0x00 0x15e0>;
			pinctrl-names = "default", "sleep";
			pinctrl-0 = <0xffffffff 0x2a>;
			pinctrl-1 = <0xffffffff 0x2a>;
			cd-gpios = <0x16 0x0c 0x01>;
			resets = <0xffffffff 0x16>;
			reset-names = "core_reset";
			qcom,iommu-dma = "fastmap";
			qcom,uses_level_shifter;
		};
	};

	fragment@16 {
		target = <0xffffffff>;

		__overlay__ {

			gpio_key {
				compatible = "gpio-keys";
				label = "gpio-keys";
				pinctrl-names = "default";
				pinctrl-0 = <0x2b>;

				vol_up {
					label = "volume_up";
					gpios = <0x16 0x06 0x01>;
					linux,input-type = <0x01>;
					linux,code = <0x73>;
					gpio-key,wakeup;
					debounce-interval = <0x0f>;
					linux,can-disable;
				};
			};
		};
	};

	fragment@17 {
		target = <0xffffffff>;

		__overlay__ {
			compatible = "qcom,ufs-phy-qmp-v4-kalama";
			vdda-phy-supply = <0xffffffff>;
			vdda-phy-max-microamp = <0x2de60>;
			vdda-pll-supply = <0xffffffff>;
			vdda-pll-max-microamp = <0x477c>;
			vdd-phy-gdsc-supply = <0xffffffff>;
			vdda-qref-supply = <0xffffffff>;
			vdda-qref-max-microamp = <0x7530>;
			status = "ok";
		};
	};

	fragment@18 {
		target = <0xffffffff>;

		__overlay__ {
			vdd-hba-supply = <0xffffffff>;
			vcc-supply = <0xffffffff>;
			vcc-max-microamp = <0x13d620>;
			vccq-supply = <0xffffffff>;
			vccq-max-microamp = <0x124f80>;
			qcom,vddp-ref-clk-supply = <0xffffffff>;
			qcom,vddp-ref-clk-max-microamp = <0x64>;
			qcom,vccq-parent-supply = <0xffffffff>;
			qcom,vccq-parent-max-microamp = <0x33450>;
			reset-gpios = <0xffffffff 0xd2 0x01>;
			resets = <0xffffffff 0x18>;
			reset-names = "rst";
			status = "ok";
		};
	};

	fragment@19 {
		target = <0xffffffff>;

		__overlay__ {
			#address-cells = <0x01>;
			#size-cells = <0x00>;
			status = "ok";
			qcom,touch-active = "goodix,gt9916S";
			qcom,la-vm;

			goodix-berlin@0 {
				compatible = "goodix,gt9916S";
				reg = <0x00>;
				spi-max-frequency = <0xf4240>;
				goodix,avdd-name = "avdd";
				avdd-supply = <0xffffffff>;
				interrupt-parent = <0xffffffff>;
				interrupts = <0x19 0x2008>;
				goodix,reset-gpio = <0xffffffff 0x18 0x00>;
				goodix,irq-gpio = <0xffffffff 0x19 0x2008>;
				goodix,irq-flags = <0x02>;
				goodix,panel-max-x = <0x438>;
				goodix,panel-max-y = <0x960>;
				goodix,panel-max-w = <0xff>;
				goodix,panel-max-p = <0x1000>;
				goodix,firmware-name = "goodix_firmware_spi.bin";
				goodix,config-name = "goodix_cfg_group_spi.bin";
				pinctrl-names = "pmx_ts_active", "pmx_ts_suspend", "pmx_ts_release";
				pinctrl-0 = <0xffffffff>;
				pinctrl-1 = <0xffffffff 0xffffffff>;
				pinctrl-2 = <0xffffffff>;
				goodix,touch-type = "primary";
				goodix,qts_en;
				qts,trusted-touch-mode = "vm_mode";
				qts,touch-environment = "pvm";
				qts,trusted-touch-type = "primary";
				qts,trusted-touch-spi-irq = <0x239>;
				qts,trusted-touch-io-bases = <0xa90000 0xac0000>;
				qts,trusted-touch-io-sizes = <0x1000 0x1000>;
				qts,trusted-touch-vm-gpio-list = <0xffffffff 0x2c 0x00 0xffffffff 0x2d 0x00 0xffffffff 0x2e 0x00 0xffffffff 0x2f 0x00 0xffffffff 0x18 0x00 0xffffffff 0x19 0x2008>;
			};
		};
	};

	fragment@20 {
		target = <0xffffffff>;

		__overlay__ {
			pinctrl-names = "unused";
			qcom,qmp-phy-override-seq = <0x156c 0xee 0x1580 0x0d 0x195c 0x3f 0x1980 0x0e>;
		};
	};

	fragment@21 {
		target = <0xffffffff>;

		__overlay__ {
			status = "ok";
			#address-cells = <0x01>;
			#size-cells = <0x00>;

			redriver@1c {
				compatible = "onnn,redriver";
				reg = <0x1c>;
				lane-channel-swap;
				pinctrl-names = "default";
				pinctrl-0 = <0xffffffff>;
				gpios = <0xffffffff 0x0b 0x00>;
				eq = <0x4040404 0x6040406>;
				flat-gain = <0x3010103 0x2010102>;
				output-comp = <0x3030303 0x3030303>;
				loss-match = <0x1030301 0x3030303>;
				phandle = <0x2c>;
			};
		};
	};

	fragment@22 {
		target = <0xffffffff>;

		__overlay__ {
			ssusb_redriver = <0x2c>;
		};
	};

	fragment@23 {
		target = <0xffffffff>;

		__overlay__ {
			dummy-supply = <0x2d>;
			usb-repeater = <0x2d>;
		};
	};

	fragment@24 {
		target = <0xffffffff>;

		__overlay__ {
			usb-role-switch;

			port {

				endpoint {
					remote-endpoint = <0x2e>;
					phandle = <0x2f>;
				};
			};

			dwc3@a600000 {
				snps,usb2-gadget-lpm-disable;
			};
		};
	};

	fragment@25 {
		target = <0xffffffff>;

		__overlay__ {

			connector {

				port {

					endpoint {
						remote-endpoint = <0x2f>;
						phandle = <0x2e>;
					};
				};
			};
		};
	};

	fragment@26 {
		target = <0xffffffff>;

		__overlay__ {
			qcom,wireless-fw-name = "idt9418.bin";
			qcom,thermal-mitigation-step = <0x7a120>;
		};
	};

	fragment@27 {
		target = <0xffffffff>;

		__overlay__ {
			qcom,pcie-phy-ver = <0x66>;
			qcom,phy-sequence = <0x240 0x03 0x00 0xc0 0x01 0x00 0xcc 0x62 0x00 0xd0 0x02 0x00 0x60 0xf8 0x00 0x64 0x01 0x00 0x00 0x93 0x00 0x04 0x01 0x00 0xe0 0x90 0x00 0xe4 0x82 0x00 0xf4 0x07 0x00 0x70 0x02 0x00 0x10 0x02 0x00 0x74 0x16 0x00 0x14 0x16 0x00 0x78 0x36 0x00 0x18 0x36 0x00 0x110 0x08 0x00 0xbc 0x0a 0x00 0x120 0x40 0x00 0x80 0x0a 0x00 0x84 0x1a 0x00 0x20 0x14 0x00 0x24 0x34 0x00 0x88 0x41 0x00 0x28 0x34 0x00 0x90 0xab 0x00 0x94 0xaa 0x00 0x98 0x01 0x00 0x30 0x55 0x00 0x34 0x55 0x00 0x38 0x01 0x00 0x140 0x14 0x00 0x164 0x34 0x00 0x3c 0x01 0x00 0x1c 0x04 0x00 0x174 0x16 0x00 0x1bc 0x0f 0x00 0x170 0xa0 0x00 0x11a4 0x38 0x00 0x10dc 0x11 0x00 0x1160 0xbf 0x00 0x1164 0xbf 0x00 0x1168 0xb7 0x00 0x116c 0xea 0x00 0x115c 0x3f 0x00 0x1174 0x5c 0x00 0x1178 0x9c 0x00 0x117c 0x1a 0x00 0x1180 0x8f 0x00 0x1170 0xdc 0x00 0x1188 0x94 0x00 0x118c 0x5b 0x00 0x1190 0x1a 0x00 0x1194 0x89 0x00 0x10cc 0x00 0x00 0x1008 0x09 0x00 0x1014 0x05 0x00 0x104c 0x08 0x00 0x1050 0x08 0x00 0x10d8 0x0f 0x00 0x1118 0x1c 0x00 0x10f8 0x07 0x00 0x11f8 0x08 0x00 0xe84 0x15 0x00 0xe90 0x3f 0x00 0xee4 0x02 0x00 0xe40 0x06 0x00 0xe3c 0x18 0x00 0x19a4 0x38 0x00 0x18dc 0x11 0x00 0x1960 0xbf 0x00 0x1964 0xbf 0x00 0x1968 0xb7 0x00 0x196c 0xea 0x00 0x195c 0x3f 0x00 0x1974 0x5c 0x00 0x1978 0x9c 0x00 0x197c 0x1a 0x00 0x1980 0x8f 0x00 0x1970 0xdc 0x00 0x1988 0x94 0x00 0x198c 0x5b 0x00 0x1990 0x1a 0x00 0x1994 0x89 0x00 0x18cc 0x00 0x00 0x1808 0x09 0x00 0x1814 0x05 0x00 0x184c 0x08 0x00 0x1850 0x08 0x00 0x18d8 0x0f 0x00 0x1918 0x1c 0x00 0x18f8 0x07 0x00 0x19f8 0x08 0x00 0x1684 0x15 0x00 0x1690 0x3f 0x00 0x16e4 0x02 0x00 0x1640 0x06 0x00 0x163c 0x18 0x00 0x2dc 0x05 0x00 0x388 0x77 0x00 0x398 0x0b 0x00 0x6a4 0x1e 0x00 0x3e0 0x0f 0x00 0x60c 0x1d 0x00 0x614 0x07 0x00 0x620 0xc1 0x00 0x694 0x00 0x00 0x3d0 0x8c 0x00 0x368 0x0f 0x00 0x1424 0x00 0x00 0x1428 0x00 0x00 0x200 0x00 0x00 0x244 0x03 0x00>;
		};
	};

	__symbols__ {
		pm8550_tz = "/fragment@0/__overlay__/qcom,pm8550@1/pm8550-temp-alarm@a00";
		pm8550_gpios = "/fragment@0/__overlay__/qcom,pm8550@1/pinctrl@8800";
		key_vol_up_default = "/fragment@0/__overlay__/qcom,pm8550@1/pinctrl@8800/key_vol_up/key_vol_up_default";
		sd_card_det_default = "/fragment@0/__overlay__/qcom,pm8550@1/pinctrl@8800/sd_card_det/sd_card_det_default";
		pm8550_pwm_1 = "/fragment@0/__overlay__/qcom,pm8550@1/pwms@e800";
		pm8550_pwm_2 = "/fragment@0/__overlay__/qcom,pm8550@1/pwms@eb00";
		pm8550_rgb = "/fragment@0/__overlay__/qcom,pm8550@1/qcom,leds@ef00";
		pm8550_bcl = "/fragment@0/__overlay__/qcom,pm8550@1/bcl@4700";
		pm8550_flash = "/fragment@0/__overlay__/qcom,pm8550@1/qcom,flash_led@ee00";
		pm8550_flash0 = "/fragment@0/__overlay__/qcom,pm8550@1/qcom,flash_led@ee00/qcom,flash_0";
		pm8550_flash1 = "/fragment@0/__overlay__/qcom,pm8550@1/qcom,flash_led@ee00/qcom,flash_1";
		pm8550_flash2 = "/fragment@0/__overlay__/qcom,pm8550@1/qcom,flash_led@ee00/qcom,flash_2";
		pm8550_flash3 = "/fragment@0/__overlay__/qcom,pm8550@1/qcom,flash_led@ee00/qcom,flash_3";
		pm8550_torch0 = "/fragment@0/__overlay__/qcom,pm8550@1/qcom,flash_led@ee00/qcom,torch_0";
		pm8550_torch1 = "/fragment@0/__overlay__/qcom,pm8550@1/qcom,flash_led@ee00/qcom,torch_1";
		pm8550_torch2 = "/fragment@0/__overlay__/qcom,pm8550@1/qcom,flash_led@ee00/qcom,torch_2";
		pm8550_torch3 = "/fragment@0/__overlay__/qcom,pm8550@1/qcom,flash_led@ee00/qcom,torch_3";
		pm8550_switch0 = "/fragment@0/__overlay__/qcom,pm8550@1/qcom,flash_led@ee00/qcom,led_switch_0";
		pm8550_switch1 = "/fragment@0/__overlay__/qcom,pm8550@1/qcom,flash_led@ee00/qcom,led_switch_1";
		pm8550_switch2 = "/fragment@0/__overlay__/qcom,pm8550@1/qcom,flash_led@ee00/qcom,led_switch_2";
		pm8550_temp_alarm = "/fragment@1/__overlay__/pm8550_tz";
		pm8550_trip0 = "/fragment@1/__overlay__/pm8550_tz/trips/trip0";
		pm8550_trip1 = "/fragment@1/__overlay__/pm8550_tz/trips/trip1";
		pm8550_trip2 = "/fragment@1/__overlay__/pm8550_tz/trips/trip2";
		bcl_lvl0 = "/fragment@1/__overlay__/pm8550-bcl-lvl0/trips/bcl-lvl0";
		bcl_lvl1 = "/fragment@1/__overlay__/pm8550-bcl-lvl1/trips/bcl-lvl1";
		bcl_lvl2 = "/fragment@1/__overlay__/pm8550-bcl-lvl2/trips/bcl-lvl2";
		pm8550b_tz = "/fragment@2/__overlay__/qcom,pm8550b@7/pm8550b-temp-alarm@a00";
		pm8550b_lite_tz = "/fragment@2/__overlay__/qcom,pm8550b@7/pm8550b-temp-alarm-lite@c00";
		pm8550b_gpios = "/fragment@2/__overlay__/qcom,pm8550b@7/pinctrl@8800";
		pm8550b_haptics = "/fragment@2/__overlay__/qcom,pm8550b@7/qcom,hv-haptics@f000";
		hap_swr_slave_reg = "/fragment@2/__overlay__/qcom,pm8550b@7/qcom,hv-haptics@f000/qcom,hap-swr-slave-reg";
		pm8550b_bcl = "/fragment@2/__overlay__/qcom,pm8550b@7/bcl@4700";
		bcl_soc = "/fragment@2/__overlay__/qcom,pm8550b@7/bcl-soc";
		pm8550b_eusb2_repeater = "/fragment@2/__overlay__/qcom,pm8550b@7/qcom,eusb2-repeater@fd00";
		pm8550b_temp_alarm = "/fragment@3/__overlay__/pm8550b_tz";
		pm8550b_trip0 = "/fragment@3/__overlay__/pm8550b_tz/trips/trip0";
		pm8550b_trip1 = "/fragment@3/__overlay__/pm8550b_tz/trips/trip1";
		pm8550b_trip2 = "/fragment@3/__overlay__/pm8550b_tz/trips/trip2";
		pm8550b_lite_temp_alarm = "/fragment@3/__overlay__/pm8550b_lite_tz";
		ibat_lvl0 = "/fragment@3/__overlay__/pm8550b-ibat-lvl0/trips/ibat-lvl0";
		ibat_lvl1 = "/fragment@3/__overlay__/pm8550b-ibat-lvl1/trips/ibat-lvl1";
		b_bcl_lvl0 = "/fragment@3/__overlay__/pm8550b-bcl-lvl0/trips/b-bcl-lvl0";
		b_bcl_lvl1 = "/fragment@3/__overlay__/pm8550b-bcl-lvl1/trips/b-bcl-lvl1";
		b_bcl_lvl2 = "/fragment@3/__overlay__/pm8550b-bcl-lvl2/trips/b-bcl-lvl2";
		socd_trip = "/fragment@3/__overlay__/socd/trips/socd-trip";
		pm8550ve_f_tz = "/fragment@4/__overlay__/qcom,pm8550ve_f@5/pm8550ve-f-temp-alarm@a00";
		pm8550ve_f_gpios = "/fragment@4/__overlay__/qcom,pm8550ve_f@5/pinctrl@8800";
		pm8550ve_f_temp_alarm = "/fragment@5/__overlay__/pm8550ve_f_tz";
		pm8550ve_f_trip0 = "/fragment@5/__overlay__/pm8550ve_f_tz/trips/trip0";
		pm8550ve_f_trip1 = "/fragment@5/__overlay__/pm8550ve_f_tz/trips/trip1";
		pm8550ve_f_trip2 = "/fragment@5/__overlay__/pm8550ve_f_tz/trips/trip2";
		pm8550vs_c = "/fragment@6/__overlay__/qcom,pm8550vs@2";
		pm8550vs_c_tz = "/fragment@6/__overlay__/qcom,pm8550vs@2/pm8550vs-c-temp-alarm@a00";
		pm8550vs_c_gpios = "/fragment@6/__overlay__/qcom,pm8550vs@2/pinctrl@8800";
		pm8550vs_d = "/fragment@6/__overlay__/qcom,pm8550vs@3";
		pm8550vs_d_tz = "/fragment@6/__overlay__/qcom,pm8550vs@3/pm8550vs-d-temp-alarm@a00";
		pm8550vs_d_gpios = "/fragment@6/__overlay__/qcom,pm8550vs@3/pinctrl@8800";
		eusb2_repeater_reset_default = "/fragment@6/__overlay__/qcom,pm8550vs@3/pinctrl@8800/eusb2_repeater_reset/eusb2_repeater_reset_default";
		pm8550vs_e = "/fragment@6/__overlay__/qcom,pm8550vs@4";
		pm8550vs_e_tz = "/fragment@6/__overlay__/qcom,pm8550vs@4/pm8550vs-e-temp-alarm@a00";
		pm8550vs_e_gpios = "/fragment@6/__overlay__/qcom,pm8550vs@4/pinctrl@8800";
		pm8550vs_g = "/fragment@6/__overlay__/qcom,pm8550vs@6";
		pm8550vs_g_tz = "/fragment@6/__overlay__/qcom,pm8550vs@6/pm8550vs-g-temp-alarm@a00";
		pm8550vs_g_gpios = "/fragment@6/__overlay__/qcom,pm8550vs@6/pinctrl@8800";
		pm8550vs_c_temp_alarm = "/fragment@7/__overlay__/pm8550vs_c_tz";
		pm8550vs_c_trip0 = "/fragment@7/__overlay__/pm8550vs_c_tz/trips/trip0";
		pm8550vs_c_trip1 = "/fragment@7/__overlay__/pm8550vs_c_tz/trips/trip1";
		pm8550vs_c_trip2 = "/fragment@7/__overlay__/pm8550vs_c_tz/trips/trip2";
		pm8550vs_d_temp_alarm = "/fragment@7/__overlay__/pm8550vs_d_tz";
		pm8550vs_d_trip0 = "/fragment@7/__overlay__/pm8550vs_d_tz/trips/trip0";
		pm8550vs_d_trip1 = "/fragment@7/__overlay__/pm8550vs_d_tz/trips/trip1";
		pm8550vs_d_trip2 = "/fragment@7/__overlay__/pm8550vs_d_tz/trips/trip2";
		pm8550vs_e_temp_alarm = "/fragment@7/__overlay__/pm8550vs_e_tz";
		pm8550vs_e_trip0 = "/fragment@7/__overlay__/pm8550vs_e_tz/trips/trip0";
		pm8550vs_e_trip1 = "/fragment@7/__overlay__/pm8550vs_e_tz/trips/trip1";
		pm8550vs_e_trip2 = "/fragment@7/__overlay__/pm8550vs_e_tz/trips/trip2";
		pm8550vs_g_temp_alarm = "/fragment@7/__overlay__/pm8550vs_g_tz";
		pm8550vs_g_trip0 = "/fragment@7/__overlay__/pm8550vs_g_tz/trips/trip0";
		pm8550vs_g_trip1 = "/fragment@7/__overlay__/pm8550vs_g_tz/trips/trip1";
		pm8550vs_g_trip2 = "/fragment@7/__overlay__/pm8550vs_g_tz/trips/trip2";
		pmk8550_sdam_1 = "/fragment@8/__overlay__/qcom,pmk8550@0/sdam@7000";
		ocp_log = "/fragment@8/__overlay__/qcom,pmk8550@0/sdam@7000/ocp-log@76";
		pmk8550_sdam_2 = "/fragment@8/__overlay__/qcom,pmk8550@0/sdam@7100";
		restart_reason = "/fragment@8/__overlay__/qcom,pmk8550@0/sdam@7100/restart@48";
		pmk8550_sdam_5 = "/fragment@8/__overlay__/qcom,pmk8550@0/sdam@7400";
		pmk8550_sdam_6 = "/fragment@8/__overlay__/qcom,pmk8550@0/sdam@7500";
		pmk8550_sdam_21 = "/fragment@8/__overlay__/qcom,pmk8550@0/sdam@8400";
		pmk8550_sdam_22 = "/fragment@8/__overlay__/qcom,pmk8550@0/sdam@8500";
		pmk8550_sdam_46 = "/fragment@8/__overlay__/qcom,pmk8550@0/sdam@9d00";
		pmk8550_gpios = "/fragment@8/__overlay__/qcom,pmk8550@0/pinctrl@b800";
		alt_sleep_clk_default = "/fragment@8/__overlay__/qcom,pmk8550@0/pinctrl@b800/alt_sleep_clk/alt_sleep_clk_default";
		pmk8550_rtc = "/fragment@8/__overlay__/qcom,pmk8550@0/rtc@6100";
		pmk8550_vadc = "/fragment@8/__overlay__/qcom,pmk8550@0/vadc@9000";
		pmr735d_k_tz = "/fragment@9/__overlay__/qcom,pmr735d@a/pmr735d-k-temp-alarm@a00";
		pmr735d_k_gpios = "/fragment@9/__overlay__/qcom,pmr735d@a/pinctrl@8800";
		pmr735d_l_tz = "/fragment@9/__overlay__/qcom,pmr735d@b/pmr735d-l-temp-alarm@a00";
		pmr735d_l_gpios = "/fragment@9/__overlay__/qcom,pmr735d@b/pinctrl@8800";
		pmr735d_k_temp_alarm = "/fragment@10/__overlay__/pmr735d_k_tz";
		pmr735d_k_trip0 = "/fragment@10/__overlay__/pmr735d_k_tz/trips/trip0";
		pmr735d_k_trip1 = "/fragment@10/__overlay__/pmr735d_k_tz/trips/trip1";
		pmr735d_k_trip2 = "/fragment@10/__overlay__/pmr735d_k_tz/trips/trip2";
		pmr735d_l_temp_alarm = "/fragment@10/__overlay__/pmr735d_l_tz";
		pmr735d_l_trip0 = "/fragment@10/__overlay__/pmr735d_l_tz/trips/trip0";
		pmr735d_l_trip1 = "/fragment@10/__overlay__/pmr735d_l_tz/trips/trip1";
		pmr735d_l_trip2 = "/fragment@10/__overlay__/pmr735d_l_tz/trips/trip2";
		pm8010_m = "/fragment@11/__overlay__/qcom,pm8010@c";
		pm8010m_tz = "/fragment@11/__overlay__/qcom,pm8010@c/pm8010-m-temp-alarm@2400";
		pm8010_n = "/fragment@11/__overlay__/qcom,pm8010@d";
		pm8010n_tz = "/fragment@11/__overlay__/qcom,pm8010@d/pm8010-n-temp-alarm@2400";
		xo_config0 = "/fragment@12/__overlay__/xo-therm/trips/xo-config0";
		xo_config1 = "/fragment@12/__overlay__/xo-therm/trips/xo-config1";
		display_test_config1 = "/fragment@12/__overlay__/xo-therm/trips/display-test-config1";
		display_test_config2 = "/fragment@12/__overlay__/xo-therm/trips/display-test-config2";
		display_test_config3 = "/fragment@12/__overlay__/xo-therm/trips/display-test-config3";
		display_test_config4 = "/fragment@12/__overlay__/xo-therm/trips/display-test-config4";
		DBO3 = "/fragment@13/__overlay__/regulator-dbo3";
		regulator_ocp_notifier = "/fragment@13/__overlay__/regulator-ocp-notifier";
		redriver = "/fragment@21/__overlay__/redriver@1c";
		usb_port0 = "/fragment@24/__overlay__/port/endpoint";
		usb_port0_connector = "/fragment@25/__overlay__/connector/port/endpoint";
	};

	__fixups__ {
		spmi_bus = "/fragment@0:target:0", "/fragment@2:target:0", "/fragment@4:target:0", "/fragment@6:target:0", "/fragment@8:target:0", "/fragment@9:target:0", "/fragment@11:target:0", "/fragment@13/__overlay__/regulator-ocp-notifier:interrupt-parent:0";
		thermal_zones = "/fragment@1:target:0", "/fragment@3:target:0", "/fragment@5:target:0", "/fragment@7:target:0", "/fragment@10:target:0", "/fragment@12:target:0", "/fragment@14:target:0";
		pm_humu_l15 = "/fragment@2/__overlay__/qcom,pm8550b@7/qcom,eusb2-repeater@fd00:vdd18-supply:0";
		pm_humu_l5 = "/fragment@2/__overlay__/qcom,pm8550b@7/qcom,eusb2-repeater@fd00:vdd3-supply:0";
		soc = "/fragment@13:target:0", "/fragment@16:target:0";
		L1B = "/fragment@13/__overlay__/regulator-ocp-notifier:periph-1c1-supply:0";
		L2B = "/fragment@13/__overlay__/regulator-ocp-notifier:periph-1c2-supply:0";
		L5B = "/fragment@13/__overlay__/regulator-ocp-notifier:periph-1c5-supply:0";
		L6B = "/fragment@13/__overlay__/regulator-ocp-notifier:periph-1c6-supply:0";
		L7B = "/fragment@13/__overlay__/regulator-ocp-notifier:periph-1c7-supply:0";
		L8B = "/fragment@13/__overlay__/regulator-ocp-notifier:periph-1c8-supply:0";
		L9B = "/fragment@13/__overlay__/regulator-ocp-notifier:periph-1c9-supply:0";
		L10B = "/fragment@13/__overlay__/regulator-ocp-notifier:periph-1ca-supply:0";
		L11B = "/fragment@13/__overlay__/regulator-ocp-notifier:periph-1cb-supply:0";
		L12B = "/fragment@13/__overlay__/regulator-ocp-notifier:periph-1cc-supply:0";
		L13B = "/fragment@13/__overlay__/regulator-ocp-notifier:periph-1cd-supply:0";
		L14B = "/fragment@13/__overlay__/regulator-ocp-notifier:periph-1ce-supply:0", "/fragment@19/__overlay__/goodix-berlin@0:avdd-supply:0";
		L15B = "/fragment@13/__overlay__/regulator-ocp-notifier:periph-1cf-supply:0";
		L16B = "/fragment@13/__overlay__/regulator-ocp-notifier:periph-1d0-supply:0";
		L17B = "/fragment@13/__overlay__/regulator-ocp-notifier:periph-1d1-supply:0";
		L1C = "/fragment@13/__overlay__/regulator-ocp-notifier:periph-2c1-supply:0";
		L3C = "/fragment@13/__overlay__/regulator-ocp-notifier:periph-2c3-supply:0";
		L1D = "/fragment@13/__overlay__/regulator-ocp-notifier:periph-3c1-supply:0";
		L2D_LEVEL = "/fragment@13/__overlay__/regulator-ocp-notifier:periph-3c2-supply:0";
		L1E = "/fragment@13/__overlay__/regulator-ocp-notifier:periph-4c1-supply:0";
		L2E = "/fragment@13/__overlay__/regulator-ocp-notifier:periph-4c2-supply:0";
		L3E = "/fragment@13/__overlay__/regulator-ocp-notifier:periph-4c3-supply:0";
		L1F = "/fragment@13/__overlay__/regulator-ocp-notifier:periph-5c1-supply:0";
		L2F = "/fragment@13/__overlay__/regulator-ocp-notifier:periph-5c2-supply:0";
		L3F = "/fragment@13/__overlay__/regulator-ocp-notifier:periph-5c3-supply:0";
		L1G = "/fragment@13/__overlay__/regulator-ocp-notifier:periph-6c1-supply:0";
		L2G = "/fragment@13/__overlay__/regulator-ocp-notifier:periph-6c2-supply:0";
		L3G = "/fragment@13/__overlay__/regulator-ocp-notifier:periph-6c3-supply:0";
		L1K = "/fragment@13/__overlay__/regulator-ocp-notifier:periph-ac1-supply:0";
		L2K = "/fragment@13/__overlay__/regulator-ocp-notifier:periph-ac2-supply:0";
		L3K = "/fragment@13/__overlay__/regulator-ocp-notifier:periph-ac3-supply:0";
		L4K = "/fragment@13/__overlay__/regulator-ocp-notifier:periph-ac4-supply:0";
		L5K = "/fragment@13/__overlay__/regulator-ocp-notifier:periph-ac5-supply:0";
		L6K = "/fragment@13/__overlay__/regulator-ocp-notifier:periph-ac6-supply:0";
		L7K = "/fragment@13/__overlay__/regulator-ocp-notifier:periph-ac7-supply:0";
		L3L = "/fragment@13/__overlay__/regulator-ocp-notifier:periph-bc3-supply:0";
		L4L = "/fragment@13/__overlay__/regulator-ocp-notifier:periph-bc4-supply:0";
		L5L = "/fragment@13/__overlay__/regulator-ocp-notifier:periph-bc5-supply:0";
		L6L = "/fragment@13/__overlay__/regulator-ocp-notifier:periph-bc6-supply:0";
		L7L = "/fragment@13/__overlay__/regulator-ocp-notifier:periph-bc7-supply:0";
		L1M = "/fragment@13/__overlay__/regulator-ocp-notifier:periph-c40-supply:0";
		L2M = "/fragment@13/__overlay__/regulator-ocp-notifier:periph-c41-supply:0";
		L3M = "/fragment@13/__overlay__/regulator-ocp-notifier:periph-c42-supply:0";
		L4M = "/fragment@13/__overlay__/regulator-ocp-notifier:periph-c43-supply:0";
		L5M = "/fragment@13/__overlay__/regulator-ocp-notifier:periph-c44-supply:0";
		L6M = "/fragment@13/__overlay__/regulator-ocp-notifier:periph-c45-supply:0";
		L7M = "/fragment@13/__overlay__/regulator-ocp-notifier:periph-c46-supply:0";
		L1N = "/fragment@13/__overlay__/regulator-ocp-notifier:periph-d40-supply:0";
		L2N = "/fragment@13/__overlay__/regulator-ocp-notifier:periph-d41-supply:0";
		L3N = "/fragment@13/__overlay__/regulator-ocp-notifier:periph-d42-supply:0";
		L4N = "/fragment@13/__overlay__/regulator-ocp-notifier:periph-d43-supply:0";
		L5N = "/fragment@13/__overlay__/regulator-ocp-notifier:periph-d44-supply:0";
		L6N = "/fragment@13/__overlay__/regulator-ocp-notifier:periph-d45-supply:0";
		L7N = "/fragment@13/__overlay__/regulator-ocp-notifier:periph-d46-supply:0";
		APC1_pause = "/fragment@14/__overlay__/socd/cooling-maps/socd_apc1:cooling-device:0", "/fragment@14/__overlay__/pm8550vs_c_tz/cooling-maps/pm8550vs_c_apc1:cooling-device:0", "/fragment@14/__overlay__/xo-therm/cooling-maps/apc1_cdev:cooling-device:0";
		cdsp_sw = "/fragment@14/__overlay__/socd/cooling-maps/socd_cdsp1:cooling-device:0", "/fragment@14/__overlay__/pm8550b-bcl-lvl0/cooling-maps/lbat_cdsp0:cooling-device:0", "/fragment@14/__overlay__/pm8550b-bcl-lvl1/cooling-maps/lbat_cdsp1:cooling-device:0", "/fragment@14/__overlay__/pm8550b-bcl-lvl2/cooling-maps/lbat_cdsp2:cooling-device:0", "/fragment@14/__overlay__/pm8550-bcl-lvl0/cooling-maps/vph_cdsp0:cooling-device:0", "/fragment@14/__overlay__/pm8550-bcl-lvl1/cooling-maps/vph_cdsp1:cooling-device:0", "/fragment@14/__overlay__/pm8550-bcl-lvl2/cooling-maps/vph_cdsp2:cooling-device:0", "/fragment@14/__overlay__/pm8550ve_f_tz/cooling-maps/pm8550vs_e_nsp:cooling-device:0", "/fragment@14/__overlay__/xo-therm/cooling-maps/cdsp_cdev:cooling-device:0";
		msm_gpu = "/fragment@14/__overlay__/socd/cooling-maps/socd_gpu0:cooling-device:0", "/fragment@14/__overlay__/pm8550b-bcl-lvl0/cooling-maps/lbat_gpu0:cooling-device:0", "/fragment@14/__overlay__/pm8550b-bcl-lvl1/cooling-maps/lbat_gpu1:cooling-device:0", "/fragment@14/__overlay__/pm8550b-bcl-lvl2/cooling-maps/lbat_gpu2:cooling-device:0", "/fragment@14/__overlay__/pm8550-bcl-lvl0/cooling-maps/vph_gpu0:cooling-device:0", "/fragment@14/__overlay__/pm8550-bcl-lvl1/cooling-maps/vph_gpu1:cooling-device:0", "/fragment@14/__overlay__/pm8550-bcl-lvl2/cooling-maps/vph_gpu2:cooling-device:0", "/fragment@14/__overlay__/pm8550vs_d_tz/cooling-maps/pm8550vs_d_gpu:cooling-device:0", "/fragment@14/__overlay__/xo-therm/cooling-maps/gpu_cdev:cooling-device:0";
		modem_lte_dsc = "/fragment@14/__overlay__/pm8550b-bcl-lvl0/cooling-maps/lbat_0_mdm_lte:cooling-device:0", "/fragment@14/__overlay__/pm8550b-bcl-lvl1/cooling-maps/lbat_1_mdm_lte:cooling-device:0", "/fragment@14/__overlay__/pm8550-bcl-lvl0/cooling-maps/vph_lte0:cooling-device:0", "/fragment@14/__overlay__/pm8550-bcl-lvl1/cooling-maps/vph_lte1:cooling-device:0", "/fragment@14/__overlay__/pm8550ve_f_tz/cooling-maps/pm8550vs_e_lte:cooling-device:0", "/fragment@14/__overlay__/xo-therm/cooling-maps/lte_cdev:cooling-device:0";
		modem_nr_scg_dsc = "/fragment@14/__overlay__/pm8550b-bcl-lvl0/cooling-maps/lbat_0_nr_scg:cooling-device:0", "/fragment@14/__overlay__/pm8550b-bcl-lvl1/cooling-maps/lbat_1_nr_scg:cooling-device:0", "/fragment@14/__overlay__/pm8550-bcl-lvl0/cooling-maps/vph_nr0_scg:cooling-device:0", "/fragment@14/__overlay__/pm8550-bcl-lvl1/cooling-maps/vph_nr1_scg:cooling-device:0", "/fragment@14/__overlay__/pm8550ve_f_tz/cooling-maps/pm8550vs_e_nr:cooling-device:0", "/fragment@14/__overlay__/xo-therm/cooling-maps/nr_cdev:cooling-device:0";
		modem_nr_dsc = "/fragment@14/__overlay__/pm8550b-bcl-lvl0/cooling-maps/lbat_0_nr:cooling-device:0", "/fragment@14/__overlay__/pm8550b-bcl-lvl1/cooling-maps/lbat_1_nr:cooling-device:0", "/fragment@14/__overlay__/pm8550-bcl-lvl0/cooling-maps/vph_nr0:cooling-device:0", "/fragment@14/__overlay__/pm8550-bcl-lvl1/cooling-maps/vph_nr1:cooling-device:0";
		cpu_3_4_5_pause = "/fragment@14/__overlay__/pm8550b-bcl-lvl0/cooling-maps/lbat_cpu_3_4_5:cooling-device:0", "/fragment@14/__overlay__/pm8550-bcl-lvl0/cooling-maps/vph_cpu_3_4_5:cooling-device:0";
		cpu_6_7_pause = "/fragment@14/__overlay__/pm8550b-bcl-lvl1/cooling-maps/lbat_cpu_6_7:cooling-device:0", "/fragment@14/__overlay__/pm8550-bcl-lvl1/cooling-maps/vph_cpu_6_7:cooling-device:0";
		cpu3_hotplug = "/fragment@14/__overlay__/xo-therm/cooling-maps/cpu3_hot_cdev:cooling-device:0";
		cpu4_hotplug = "/fragment@14/__overlay__/xo-therm/cooling-maps/cpu4_hot_cdev:cooling-device:0";
		cpu5_hotplug = "/fragment@14/__overlay__/xo-therm/cooling-maps/cpu5_hot_cdev:cooling-device:0";
		cpu6_hotplug = "/fragment@14/__overlay__/xo-therm/cooling-maps/cpu6_hot_cdev:cooling-device:0";
		cpu7_hotplug = "/fragment@14/__overlay__/xo-therm/cooling-maps/cpu7_hot_cdev:cooling-device:0";
		display_fps = "/fragment@14/__overlay__/xo-therm/cooling-maps/display_cdev1:cooling-device:0", "/fragment@14/__overlay__/xo-therm/cooling-maps/display_cdev2:cooling-device:0", "/fragment@14/__overlay__/xo-therm/cooling-maps/display_cdev3:cooling-device:0", "/fragment@14/__overlay__/xo-therm/cooling-maps/display_cdev4:cooling-device:0";
		sdhc_2 = "/fragment@15:target:0";
		pm_humu_l9 = "/fragment@15/__overlay__:vdd-supply:0";
		pm_humu_l8 = "/fragment@15/__overlay__:vdd-io-supply:0";
		sdc2_on = "/fragment@15/__overlay__:pinctrl-0:0";
		sdc2_off = "/fragment@15/__overlay__:pinctrl-1:0";
		gcc = "/fragment@15/__overlay__:resets:0", "/fragment@18/__overlay__:resets:0";
		ufsphy_mem = "/fragment@17:target:0";
		pm_v6d_l1 = "/fragment@17/__overlay__:vdda-phy-supply:0";
		pm_v6e_l3 = "/fragment@17/__overlay__:vdda-pll-supply:0";
		gcc_ufs_mem_phy_gdsc = "/fragment@17/__overlay__:vdd-phy-gdsc-supply:0";
		pm_v6e_l1 = "/fragment@17/__overlay__:vdda-qref-supply:0";
		ufshc_mem = "/fragment@18:target:0";
		gcc_ufs_phy_gdsc = "/fragment@18/__overlay__:vdd-hba-supply:0";
		pm_humu_l17 = "/fragment@18/__overlay__:vcc-supply:0";
		pm_v6g_l1 = "/fragment@18/__overlay__:vccq-supply:0";
		pm_v6g_l3 = "/fragment@18/__overlay__:qcom,vddp-ref-clk-supply:0";
		pm_v6g_s4 = "/fragment@18/__overlay__:qcom,vccq-parent-supply:0";
		tlmm = "/fragment@18/__overlay__:reset-gpios:0", "/fragment@19/__overlay__/goodix-berlin@0:interrupt-parent:0", "/fragment@19/__overlay__/goodix-berlin@0:goodix,reset-gpio:0", "/fragment@19/__overlay__/goodix-berlin@0:goodix,irq-gpio:0", "/fragment@19/__overlay__/goodix-berlin@0:qts,trusted-touch-vm-gpio-list:0", "/fragment@19/__overlay__/goodix-berlin@0:qts,trusted-touch-vm-gpio-list:12", "/fragment@19/__overlay__/goodix-berlin@0:qts,trusted-touch-vm-gpio-list:24", "/fragment@19/__overlay__/goodix-berlin@0:qts,trusted-touch-vm-gpio-list:36", "/fragment@19/__overlay__/goodix-berlin@0:qts,trusted-touch-vm-gpio-list:48", "/fragment@19/__overlay__/goodix-berlin@0:qts,trusted-touch-vm-gpio-list:60", "/fragment@21/__overlay__/redriver@1c:gpios:0";
		qupv3_se4_spi = "/fragment@19:target:0";
		ts_active = "/fragment@19/__overlay__/goodix-berlin@0:pinctrl-0:0";
		ts_int_suspend = "/fragment@19/__overlay__/goodix-berlin@0:pinctrl-1:0";
		ts_reset_suspend = "/fragment@19/__overlay__/goodix-berlin@0:pinctrl-1:4";
		ts_release = "/fragment@19/__overlay__/goodix-berlin@0:pinctrl-2:0";
		usb_qmp_dp_phy = "/fragment@20:target:0";
		qupv3_hub_i2c2 = "/fragment@21:target:0";
		usb3phy_portselect_gpio = "/fragment@21/__overlay__/redriver@1c:pinctrl-0:0";
		usb0 = "/fragment@22:target:0", "/fragment@24:target:0";
		eusb2_phy0 = "/fragment@23:target:0";
		ucsi = "/fragment@25:target:0";
		battery_charger = "/fragment@26:target:0";
		pcie0 = "/fragment@27:target:0";
	};

	__local_fixups__ {

		fragment@0 {

			__overlay__ {

				qcom,pm8550@1 {

					pm8550-temp-alarm@a00 {
						io-channels = <0x00>;
					};

					pwms@e800 {
						nvmem = <0x00 0x04>;
					};

					qcom,leds@ef00 {

						red {
							pwms = <0x00>;
						};

						green {
							pwms = <0x00>;
						};

						blue {
							pwms = <0x00>;
						};
					};
				};
			};
		};

		fragment@1 {

			__overlay__ {

				pm8550_tz {
					thermal-sensors = <0x00>;
				};

				pm8550-bcl-lvl0 {
					thermal-sensors = <0x00>;
				};

				pm8550-bcl-lvl1 {
					thermal-sensors = <0x00>;
				};

				pm8550-bcl-lvl2 {
					thermal-sensors = <0x00>;
				};
			};
		};

		fragment@2 {

			__overlay__ {

				qcom,pm8550b@7 {

					pm8550b-temp-alarm@a00 {
						io-channels = <0x00>;
					};

					pm8550b-temp-alarm-lite@c00 {
						io-channels = <0x00>;
					};

					qcom,hv-haptics@f000 {
						nvmem = <0x00>;
					};
				};
			};
		};

		fragment@3 {

			__overlay__ {

				pm8550b_tz {
					thermal-sensors = <0x00>;
				};

				pm8550b_lite_tz {
					thermal-sensors = <0x00>;
				};

				pm8550b-ibat-lvl0 {
					thermal-sensors = <0x00>;
				};

				pm8550b-ibat-lvl1 {
					thermal-sensors = <0x00>;
				};

				pm8550b-bcl-lvl0 {
					thermal-sensors = <0x00>;
				};

				pm8550b-bcl-lvl1 {
					thermal-sensors = <0x00>;
				};

				pm8550b-bcl-lvl2 {
					thermal-sensors = <0x00>;
				};
			};
		};

		fragment@4 {

			__overlay__ {

				qcom,pm8550ve_f@5 {

					pm8550ve-f-temp-alarm@a00 {
						io-channels = <0x00>;
					};
				};
			};
		};

		fragment@5 {

			__overlay__ {

				pm8550ve_f_tz {
					thermal-sensors = <0x00>;
				};
			};
		};

		fragment@6 {

			__overlay__ {

				qcom,pm8550vs@2 {

					pm8550vs-c-temp-alarm@a00 {
						io-channels = <0x00>;
					};
				};

				qcom,pm8550vs@3 {

					pm8550vs-d-temp-alarm@a00 {
						io-channels = <0x00>;
					};
				};

				qcom,pm8550vs@4 {

					pm8550vs-e-temp-alarm@a00 {
						io-channels = <0x00>;
					};
				};

				qcom,pm8550vs@6 {

					pm8550vs-g-temp-alarm@a00 {
						io-channels = <0x00>;
					};
				};
			};
		};

		fragment@7 {

			__overlay__ {

				pm8550vs_c_tz {
					thermal-sensors = <0x00>;
				};

				pm8550vs_d_tz {
					thermal-sensors = <0x00>;
				};

				pm8550vs_e_tz {
					thermal-sensors = <0x00>;
				};

				pm8550vs_g_tz {
					thermal-sensors = <0x00>;
				};
			};
		};

		fragment@8 {

			__overlay__ {

				qcom,pmk8550@0 {

					pinctrl@b800 {
						pinctrl-0 = <0x00>;
					};
				};
			};
		};

		fragment@10 {

			__overlay__ {

				pmr735d_k_tz {
					thermal-sensors = <0x00>;
				};

				pmr735d_l_tz {
					thermal-sensors = <0x00>;
				};
			};
		};

		fragment@12 {

			__overlay__ {

				pm8010m_tz {
					thermal-sensors = <0x00>;
				};

				pm8010n_tz {
					thermal-sensors = <0x00>;
				};

				xo-therm {
					thermal-sensors = <0x00>;
				};
			};
		};

		fragment@13 {

			__overlay__ {

				reboot_reason {
					nvmem-cells = <0x00>;
				};

				regulator-dbo3 {
					gpio = <0x00>;
				};

				pmic-pon-log {
					nvmem = <0x00 0x04>;
				};

				regulator-ocp-notifier {
					nvmem-cells = <0x00>;
				};
			};
		};

		fragment@14 {

			__overlay__ {

				socd {

					cooling-maps {

						socd_apc1 {
							trip = <0x00>;
						};

						socd_cdsp1 {
							trip = <0x00>;
						};

						socd_gpu0 {
							trip = <0x00>;
						};
					};
				};

				pm8550b-bcl-lvl0 {

					cooling-maps {

						lbat_0_mdm_lte {
							trip = <0x00>;
						};

						lbat_0_nr_scg {
							trip = <0x00>;
						};

						lbat_0_nr {
							trip = <0x00>;
						};

						lbat_cpu_3_4_5 {
							trip = <0x00>;
						};

						lbat_cdsp0 {
							trip = <0x00>;
						};

						lbat_gpu0 {
							trip = <0x00>;
						};
					};
				};

				pm8550b-bcl-lvl1 {

					cooling-maps {

						lbat_1_mdm_lte {
							trip = <0x00>;
						};

						lbat_1_nr_scg {
							trip = <0x00>;
						};

						lbat_1_nr {
							trip = <0x00>;
						};

						lbat_cpu_6_7 {
							trip = <0x00>;
						};

						lbat_cdsp1 {
							trip = <0x00>;
						};

						lbat_gpu1 {
							trip = <0x00>;
						};
					};
				};

				pm8550b-bcl-lvl2 {

					cooling-maps {

						lbat_cdsp2 {
							trip = <0x00>;
						};

						lbat_gpu2 {
							trip = <0x00>;
						};
					};
				};

				pm8550-bcl-lvl0 {

					cooling-maps {

						vph_lte0 {
							trip = <0x00>;
						};

						vph_nr0_scg {
							trip = <0x00>;
						};

						vph_nr0 {
							trip = <0x00>;
						};

						vph_cpu_3_4_5 {
							trip = <0x00>;
						};

						vph_cdsp0 {
							trip = <0x00>;
						};

						vph_gpu0 {
							trip = <0x00>;
						};
					};
				};

				pm8550-bcl-lvl1 {

					cooling-maps {

						vph_lte1 {
							trip = <0x00>;
						};

						vph_nr1_scg {
							trip = <0x00>;
						};

						vph_nr1 {
							trip = <0x00>;
						};

						vph_cpu_6_7 {
							trip = <0x00>;
						};

						vph_cdsp1 {
							trip = <0x00>;
						};

						vph_gpu1 {
							trip = <0x00>;
						};
					};
				};

				pm8550-bcl-lvl2 {

					cooling-maps {

						vph_cdsp2 {
							trip = <0x00>;
						};

						vph_gpu2 {
							trip = <0x00>;
						};
					};
				};

				pm8550vs_c_tz {

					cooling-maps {

						pm8550vs_c_apc1 {
							trip = <0x00>;
						};
					};
				};

				pm8550vs_d_tz {

					cooling-maps {

						pm8550vs_d_gpu {
							trip = <0x00>;
						};
					};
				};

				pm8550ve_f_tz {

					cooling-maps {

						pm8550vs_e_nsp {
							trip = <0x00>;
						};

						pm8550vs_e_lte {
							trip = <0x00>;
						};

						pm8550vs_e_nr {
							trip = <0x00>;
						};
					};
				};

				xo-therm {

					cooling-maps {

						apc1_cdev {
							trip = <0x00>;
						};

						cdsp_cdev {
							trip = <0x00>;
						};

						gpu_cdev {
							trip = <0x00>;
						};

						cpu3_hot_cdev {
							trip = <0x00>;
						};

						cpu4_hot_cdev {
							trip = <0x00>;
						};

						cpu5_hot_cdev {
							trip = <0x00>;
						};

						cpu6_hot_cdev {
							trip = <0x00>;
						};

						cpu7_hot_cdev {
							trip = <0x00>;
						};

						lte_cdev {
							trip = <0x00>;
						};

						nr_cdev {
							trip = <0x00>;
						};

						display_cdev1 {
							trip = <0x00>;
						};

						display_cdev2 {
							trip = <0x00>;
						};

						display_cdev3 {
							trip = <0x00>;
						};

						display_cdev4 {
							trip = <0x00>;
						};
					};
				};
			};
		};

		fragment@15 {

			__overlay__ {
				pinctrl-0 = <0x04>;
				pinctrl-1 = <0x04>;
				cd-gpios = <0x00>;
			};
		};

		fragment@16 {

			__overlay__ {

				gpio_key {
					pinctrl-0 = <0x00>;

					vol_up {
						gpios = <0x00>;
					};
				};
			};
		};

		fragment@22 {

			__overlay__ {
				ssusb_redriver = <0x00>;
			};
		};

		fragment@23 {

			__overlay__ {
				dummy-supply = <0x00>;
				usb-repeater = <0x00>;
			};
		};

		fragment@24 {

			__overlay__ {

				port {

					endpoint {
						remote-endpoint = <0x00>;
					};
				};
			};
		};

		fragment@25 {

			__overlay__ {

				connector {

					port {

						endpoint {
							remote-endpoint = <0x00>;
						};
					};
				};
			};
		};
	};
};
